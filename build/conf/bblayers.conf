## build/meta-bsp/recipes-bsp/linux/files/its/verdin-imx8mp.its
```
/*
 * Copyright (C) 2020-2026 EDGEMTech SA <info@edgemtech.ch>
 *
 * Bare Linux ITS for the Toradex Verdin iMX8MP. Single ITB carrying
 * kernel + DTB + initrd, bootm'd directly by U-Boot. No AVZ: this is
 * the IB_HYPERVISOR="none" shape, on either of the two firmware chains
 * the iMX8MP supports ("atf+uboot" or "atf+optee+uboot") — the SoC boot
 * ROM always needs BL31, so there is no bare-U-Boot variant here.
 *
 * Template: ${IB_*_PATH} placeholders are expanded to absolute build
 * paths by bsp_render_its (bsp.bbclass) at do_itb time.
 *
 * The AVZ path uses verdin-imx8mp_avz.its + verdin-imx8mp_linux_guest.its
 * instead — see those files for the two-ITB guest-boot variant.
 *
 * This program is free software; you can redistribute it and/or modify
 * it under the terms of the GNU General Public License version 2 as
 * published by the Free Software Foundation.
 *
 * This program is distributed in the hope that it will be useful,
 * but WITHOUT ANY WARRANTY; without even the implied warranty of
 * MERCHANTABILITY or FITNESS FOR A PARTICULAR PURPOSE.  See the
 * GNU General Public License for more details.
 *
 * You should have received a copy of the GNU General Public License
 * along with this program; if not, write to the Free Software
 * Foundation, Inc., 51 Franklin St, Fifth Floor, Boston, MA  02110-1301  USA
 *
 */

/dts-v1/;

/ {
	description = "Kernel and rootfs components for verdin-imx8mp (arm64) environment";

	images {

		linux {
			description = "Linux kernel";
			data = /incbin/("${IB_LINUX_PATH}/arch/arm64/boot/Image");
			type = "kernel";
			arch = "arm64";
			os = "linux";
			compression = "none";
			load = <0x40400000>;
			entry = <0x40400000>;
		};

		fdt_linux {
			description = "Linux device tree blob";
			data = /incbin/("${IB_LINUX_PATH}/arch/arm64/boot/dts/freescale/imx8mp-verdin-wifi-mallow.dtb");
			type = "flat_dt";
			arch = "arm64";
			compression = "none";
			load = <0x50200000>;
		};

		initrd {
			description = "Initial rootfs (initramfs)";
			data = /incbin/("${IB_ROOTFS_PATH}/board/${IB_PLATFORM}/initrd.cpio.gz");
			type = "ramdisk";
			arch = "arm64";
			os = "linux";
			compression = "none";
			load = <0x50300000>;
		};
	};

	configurations {
		default = "conf_linux";

		conf_linux {
			description = "Linux on Verdin iMX8MP";
			kernel = "linux";
			fdt = "fdt_linux";
			ramdisk = "initrd";
		};
	};
};
```

## build/meta-bsp/recipes-bsp/linux/files/its/verdin-imx8mp_avz.its
```
/*
 * Copyright (C) 2020-2026 EDGEMTech SA <info@edgemtech.ch>
 *
 * AVZ ITS for the Toradex Verdin iMX8MP. Carries only the AVZ hypervisor
 * binary (so3.bin) + the AVZ device tree. The guest lives in a SEPARATE
 * ITB (verdin-imx8mp_linux_guest.its); both are loaded by U-Boot's
 * guest-boot command, which passes the AVZ FIT in x0 and the guest ITB
 * in x1.
 *
 * Template: ${IB_*_PATH} placeholders are expanded to absolute build
 * paths by bsp_render_its (bsp.bbclass) at do_itb time.
 *
 * The bare path uses verdin-imx8mp.its instead — see that file for the
 * single-ITB bootm variant without AVZ.
 *
 * This program is free software; you can redistribute it and/or modify
 * it under the terms of the GNU General Public License version 2 as
 * published by the Free Software Foundation.
 *
 * This program is distributed in the hope that it will be useful,
 * but WITHOUT ANY WARRANTY; without even the implied warranty of
 * MERCHANTABILITY or FITNESS FOR A PARTICULAR PURPOSE.  See the
 * GNU General Public License for more details.
 *
 * You should have received a copy of the GNU General Public License
 * along with this program; if not, write to the Free Software
 * Foundation, Inc., 51 Franklin St, Fifth Floor, Boston, MA  02110-1301  USA
 *
 */

/dts-v1/;

/ {
	description = "AVZ Hypervisor bundle for the Toradex Verdin iMX8MP";

	images {

		avz {
			description = "AVZ Hypervisor (64-bit) Polymorphic SO3";
			data = /incbin/("${IB_AVZ_PATH}/so3.bin");
			type = "kernel";
			os = "linux";
			arch = "arm64";
			compression = "none";
			load = <0x40080000>;
			entry = <0x40080000>;
		};

		avz_dt {
			description = "AVZ flattened device tree blob";
			data = /incbin/("${IB_AVZ_PATH}/dts/verdin-imx8mp_avz.dtb");
			type = "avz_dt";
			arch = "arm64";
			compression = "none";
			load = <0x46000000>;
		};
	};

	configurations {
		default = "avz";

		avz {
			description = "AVZ hypervisor on Verdin iMX8MP";
			kernel = "avz";
			loadables = "avz_dt";
			fdt = "avz_dt";
		};
	};
};
```

## build/meta-bsp/recipes-bsp/linux/files/its/verdin-imx8mp_linux_guest.its
```
/*
 * Copyright (C) 2020-2026 EDGEMTech SA <info@edgemtech.ch>
 *
 * Linux guest ITS for the Toradex Verdin iMX8MP running on AVZ. Paired
 * with verdin-imx8mp_avz.its: U-Boot's guest-boot command loads both
 * ITBs and hands the guest FIT to AVZ in x1, which loads the guest from
 * it. The kernel node is type "guest" (not "kernel") so U-Boot stages it
 * without trying to boot it itself.
 *
 * The device tree is imx8mp-verdin-avz-guest.dtb — the Verdin DT reduced
 * to the memory range AVZ grants the guest. Torizon DT overlays are NOT
 * merged here: that is an edge-m1 product concern, and this generic BSP
 * boots the buildroot rootfs.
 *
 * Template: ${IB_*_PATH} placeholders are expanded to absolute build
 * paths by bsp_render_its (bsp.bbclass) at do_itb time.
 *
 * This program is free software; you can redistribute it and/or modify
 * it under the terms of the GNU General Public License version 2 as
 * published by the Free Software Foundation.
 *
 * This program is distributed in the hope that it will be useful,
 * but WITHOUT ANY WARRANTY; without even the implied warranty of
 * MERCHANTABILITY or FITNESS FOR A PARTICULAR PURPOSE.  See the
 * GNU General Public License for more details.
 *
 * You should have received a copy of the GNU General Public License
 * along with this program; if not, write to the Free Software
 * Foundation, Inc., 51 Franklin St, Fifth Floor, Boston, MA  02110-1301  USA
 *
 */

/dts-v1/;

/ {
	description = "Linux guest bundle for the Toradex Verdin iMX8MP";

	images {

		linux {
			description = "Linux kernel (guest)";
			data = /incbin/("${IB_LINUX_PATH}/arch/arm64/boot/Image");
			type = "guest";
			arch = "arm64";
			os = "linux";
			compression = "none";
			load = <0x48000000>;
			entry = <0x48000000>;
		};

		fdt {
			description = "Linux guest device tree (AVZ: reduced memory)";
			data = /incbin/("${IB_LINUX_PATH}/arch/arm64/boot/dts/freescale/imx8mp-verdin-avz-guest.dtb");
			type = "flat_dt";
			arch = "arm64";
			compression = "none";
			load = <0x50200000>;
		};

		initrd {
			description = "Linux initrd";
			data = /incbin/("${IB_ROOTFS_PATH}/board/${IB_PLATFORM}/initrd.cpio.gz");
			type = "ramdisk";
			arch = "arm64";
			os = "linux";
			compression = "none";
			load = <0x50300000>;
		};
	};

	configurations {
		default = "guest";

		guest {
			description = "Linux guest on AVZ (Verdin iMX8MP)";
			loadables = "linux";
			fdt = "fdt";
			ramdisk = "initrd";
		};
	};
};
```
