/dts-v1/;

/ {
	compatible = "brcm,bcm2835";

	fragment@0 {
		target = <0xffffffff>;

		__overlay__ {

			button_pins@0 {
				brcm,pins = <0x03>;
				brcm,function = <0x00>;
				brcm,pull = <0x02>;
				phandle = <0x01>;
			};
		};
	};

	fragment@1 {
		target-path = "/";

		__overlay__ {

			button@0 {
				compatible = "gpio-keys";
				pinctrl-names = "default";
				pinctrl-0 = <0x01>;
				status = "okay";
				phandle = <0x03>;

				key {
					linux,code = <0x74>;
					gpios = <0xffffffff 0x03 0x01>;
					label = "KEY_POWER";
					phandle = <0x02>;
				};
			};
		};
	};

	__overrides__ {
		gpio = <0x02 0x6770696f 0x733a3400 0x03 0x7265673a 0x30000000 0x16272 0x636d2c70 0x696e733a 0x30000000 0x17265 0x673a3000>;
		label = [00 00 00 02 6c 61 62 65 6c 00];
		keycode = [00 00 00 02 6c 69 6e 75 78 2c 63 6f 64 65 3a 30 00];
		gpio_pull = <0x01 0x6272636d 0x2c70756c 0x6c3a3000>;
		active_low = <0x02 0x6770696f 0x733a3800>;
	};

	__symbols__ {
		pin_state = "/fragment@0/__overlay__/button_pins@0";
		button = "/fragment@1/__overlay__/button@0";
		key = "/fragment@1/__overlay__/button@0/key";
	};

	__fixups__ {
		gpio = "/fragment@0:target:0\0/fragment@1/__overlay__/button@0/key:gpios:0";
	};

	__local_fixups__ {

		fragment@1 {

			__overlay__ {

				button@0 {
					pinctrl-0 = <0x00>;
				};
			};
		};

		__overrides__ {
			gpio = <0x00 0x0c 0x16 0x26>;
			label = <0x00>;
			keycode = <0x00>;
			gpio_pull = <0x00>;
			active_low = <0x00>;
		};
	};
};
