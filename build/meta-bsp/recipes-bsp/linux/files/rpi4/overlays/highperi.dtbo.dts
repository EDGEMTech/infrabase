/dts-v1/;

/ {
	compatible = "brcm,bcm2711";

	fragment@0 {
		target = <0xffffffff>;
		#address-cells = <0x02>;
		#size-cells = <0x01>;

		__overlay__ {
			#address-cells = <0x01>;
			#size-cells = <0x01>;
			ranges = <0x7c000000 0x04 0x7c000000 0x4000000 0x40000000 0x04 0xc0000000 0x800000>;
		};
	};

	fragment@1 {
		target = <0xffffffff>;
		#address-cells = <0x02>;
		#size-cells = <0x01>;

		__overlay__ {
			#address-cells = <0x02>;
			#size-cells = <0x02>;
			ranges = <0x00 0x7c000000 0x04 0x7c000000 0x00 0x4000000 0x00 0x40000000 0x04 0xc0000000 0x00 0x800000 0x06 0x00 0x06 0x00 0x00 0x40000000>;
			dma-ranges = <0x00 0x00 0x00 0x00 0x02 0x00>;
		};
	};

	fragment@2 {
		target = <0xffffffff>;
		#address-cells = <0x02>;
		#size-cells = <0x01>;

		__overlay__ {
			#address-cells = <0x01>;
			#size-cells = <0x02>;
			ranges = <0x7c500000 0x04 0x7c500000 0x00 0x3300000 0x40000000 0x04 0xc0000000 0x00 0x800000>;
		};
	};

	fragment@3 {
		target = <0xffffffff>;
		#address-cells = <0x02>;
		#size-cells = <0x01>;

		__overlay__ {
			#address-cells = <0x02>;
			#size-cells = <0x01>;
			ranges = <0x00 0x7e000000 0x04 0x7e000000 0x1800000>;
		};
	};

	__fixups__ {
		soc = "/fragment@0:target:0";
		scb = "/fragment@1:target:0";
		v3dbus = "/fragment@2:target:0";
		emmc2bus = "/fragment@3:target:0";
	};
};
