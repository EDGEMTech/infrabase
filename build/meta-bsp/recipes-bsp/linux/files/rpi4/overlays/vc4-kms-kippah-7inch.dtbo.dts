/dts-v1/;

/ {
	compatible = "brcm,bcm2835";

	fragment@0 {
		target-path = "/";

		__overlay__ {

			panel {
				compatible = "ontat,yx700wv03\0simple-panel";
				phandle = <0x03>;

				port {

					endpoint {
						remote-endpoint = <0x01>;
						phandle = <0x02>;
					};
				};
			};
		};
	};

	fragment@1 {
		target = <0xffffffff>;

		__overlay__ {
			status = "okay";
			pinctrl-names = "default";
			pinctrl-0 = <0xffffffff>;

			port {

				endpoint@0 {
					remote-endpoint = <0x02>;
					phandle = <0x01>;
				};
			};
		};
	};

	__symbols__ {
		panel = "/fragment@0/__overlay__/panel";
		panel_in = "/fragment@0/__overlay__/panel/port/endpoint";
		dpi_out = "/fragment@1/__overlay__/port/endpoint@0";
	};

	__fixups__ {
		dpi = "/fragment@1:target:0";
		dpi_18bit_gpio0 = "/fragment@1/__overlay__:pinctrl-0:0";
	};

	__local_fixups__ {

		fragment@0 {

			__overlay__ {

				panel {

					port {

						endpoint {
							remote-endpoint = <0x00>;
						};
					};
				};
			};
		};

		fragment@1 {

			__overlay__ {

				port {

					endpoint@0 {
						remote-endpoint = <0x00>;
					};
				};
			};
		};
	};
};
