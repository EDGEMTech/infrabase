/dts-v1/;

/ {
	compatible = "brcm,bcm2835";

	fragment@0 {
		target = <0xffffffff>;

		__overlay__ {
			#address-cells = <0x01>;
			#size-cells = <0x00>;
			status = "okay";

			pca@41 {
				compatible = "nxp,pca9536";
				reg = <0x41>;
				gpio-controller;
				#gpio-cells = <0x02>;
				status = "okay";
				phandle = <0x02>;
			};
		};
	};

	fragment@1 {
		target = <0xffffffff>;

		__overlay__ {
			status = "okay";
			#address-cells = <0x01>;
			#size-cells = <0x00>;

			port {

				endpoint {
					remote-endpoint = <0x01>;
					phandle = <0x03>;
				};
			};

			lt070me05000@0 {
				compatible = "jdi,lt070me05000";
				status = "okay";
				reg = <0x00>;
				reset-gpios = <0x02 0x00 0x01>;
				enable-gpios = <0x02 0x02 0x00>;
				dcdc-en-gpios = <0x02 0x01 0x00>;
				phandle = <0x04>;

				port {

					endpoint {
						remote-endpoint = <0x03>;
						phandle = <0x01>;
					};
				};
			};
		};
	};

	__symbols__ {
		pca = "/fragment@0/__overlay__/pca@41";
		dsi_out_port = "/fragment@1/__overlay__/port/endpoint";
		lt070me05000 = "/fragment@1/__overlay__/lt070me05000@0";
		panel_dsi_port = "/fragment@1/__overlay__/lt070me05000@0/port/endpoint";
	};

	__fixups__ {
		i2c_csi_dsi = "/fragment@0:target:0";
		dsi1 = "/fragment@1:target:0";
	};

	__local_fixups__ {

		fragment@1 {

			__overlay__ {

				port {

					endpoint {
						remote-endpoint = <0x00>;
					};
				};

				lt070me05000@0 {
					reset-gpios = <0x00>;
					enable-gpios = <0x00>;
					dcdc-en-gpios = <0x00>;

					port {

						endpoint {
							remote-endpoint = <0x00>;
						};
					};
				};
			};
		};
	};
};
