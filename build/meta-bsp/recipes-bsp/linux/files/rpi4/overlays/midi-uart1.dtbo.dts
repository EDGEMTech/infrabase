/dts-v1/;

/ {
	compatible = "brcm,bcm2835";

	fragment@0 {
		target-path = "/clocks";

		__overlay__ {

			clock@5 {
				compatible = "fixed-factor-clock";
				#clock-cells = <0x00>;
				clocks = <0xffffffff 0x00>;
				clock-mult = <0x9600>;
				clock-div = <0x7a12>;
				phandle = <0x01>;
			};
		};
	};

	fragment@1 {
		target = <0xffffffff>;

		__overlay__ {
			clocks = <0x01>;
		};
	};

	fragment@2 {
		target = <0xffffffff>;

		__overlay__ {
			clock-output-names = "aux_uart\0aux_spi1\0aux_spi2";
		};
	};

	__symbols__ {
		midi_clk = "/fragment@0/__overlay__/clock@5";
	};

	__fixups__ {
		aux = "/fragment@0/__overlay__/clock@5:clocks:0\0/fragment@2:target:0";
		uart1 = "/fragment@1:target:0";
	};

	__local_fixups__ {

		fragment@1 {

			__overlay__ {
				clocks = <0x00>;
			};
		};
	};
};
