/dts-v1/;

/ {
	compatible = "brcm,bcm2835";

	fragment@0 {
		target = <0xffffffff>;

		__overlay__ {
			clocks = <0xffffffff 0x1f>;
			clock-names = "pcm";
			status = "okay";
		};
	};

	fragment@1 {
		target-path = "/";

		__overlay__ {

			regulators {
				compatible = "simple-bus";
				#address-cells = <0x01>;
				#size-cells = <0x00>;

				udrc0_ldoin {
					compatible = "regulator-fixed";
					regulator-name = "ldoin";
					regulator-min-microvolt = <0x325aa0>;
					regulator-max-microvolt = <0x325aa0>;
					regulator-always-on;
					phandle = <0x03>;
				};
			};
		};
	};

	fragment@2 {
		target = <0xffffffff>;

		__overlay__ {
			#address-cells = <0x01>;
			#size-cells = <0x00>;
			status = "okay";
			clocks = <0xffffffff 0x14>;
			clock-frequency = <0x61a80>;

			tlv320aic32x4@18 {
				compatible = "ti,tlv320aic32x4";
				#sound-dai-cells = <0x00>;
				reg = <0x18>;
				status = "okay";
				clocks = <0xffffffff 0x26>;
				clock-names = "mclk";
				assigned-clocks = <0xffffffff 0x26>;
				assigned-clock-rates = <0x17d7840>;
				pinctrl-names = "default";
				pinctrl-0 = <0x01 0x02>;
				reset-gpios = <0xffffffff 0x0d 0x00>;
				iov-supply = <0x03>;
				ldoin-supply = <0x03>;
				phandle = <0x05>;
			};
		};
	};

	fragment@3 {
		target = <0xffffffff>;

		__overlay__ {
			compatible = "simple-audio-card";
			i2s-controller = <0xffffffff>;
			status = "okay";
			simple-audio-card,name = "udrc";
			simple-audio-card,format = "i2s";
			simple-audio-card,bitclock-master = <0x04>;
			simple-audio-card,frame-master = <0x04>;
			simple-audio-card,widgets = "Line\0Line In\0Line\0Line Out";
			simple-audio-card,routing = "IN1_R\0Line In\0IN1_L\0Line In\0CM_L\0Line In\0CM_R\0Line In\0Line Out\0LOR\0Line Out\0LOL";
			phandle = <0x06>;

			simple-audio-card,cpu {
				sound-dai = <0xffffffff>;
				phandle = <0x04>;
			};

			simple-audio-card,codec {
				sound-dai = <0x05>;
			};
		};
	};

	fragment@4 {
		target = <0xffffffff>;

		__overlay__ {

			gpclk0_pin {
				brcm,pins = <0x04>;
				brcm,function = <0x04>;
				phandle = <0x01>;
			};

			aic3204_reset {
				brcm,pins = <0x0d>;
				brcm,function = <0x01>;
				brcm,pull = <0x01>;
				phandle = <0x02>;
			};

			aic3204_gpio {
				brcm,pins = <0x1a>;
				phandle = <0x07>;
			};
		};
	};

	__overrides__ {
		alsaname = [00 00 00 06 73 69 6d 70 6c 65 2d 61 75 64 69 6f 2d 63 61 72 64 2c 6e 61 6d 65 00];
	};

	__symbols__ {
		udrc0_ldoin = "/fragment@1/__overlay__/regulators/udrc0_ldoin";
		tlv320aic32x4 = "/fragment@2/__overlay__/tlv320aic32x4@18";
		snd = "/fragment@3/__overlay__";
		dailink0_master = "/fragment@3/__overlay__/simple-audio-card,cpu";
		gpclk0_pin = "/fragment@4/__overlay__/gpclk0_pin";
		aic3204_reset = "/fragment@4/__overlay__/aic3204_reset";
		aic3204_gpio = "/fragment@4/__overlay__/aic3204_gpio";
	};

	__fixups__ {
		i2s = "/fragment@0:target:0\0/fragment@3/__overlay__:i2s-controller:0\0/fragment@3/__overlay__/simple-audio-card,cpu:sound-dai:0";
		clocks = "/fragment@0/__overlay__:clocks:0\0/fragment@2/__overlay__:clocks:0\0/fragment@2/__overlay__/tlv320aic32x4@18:clocks:0\0/fragment@2/__overlay__/tlv320aic32x4@18:assigned-clocks:0";
		i2c1 = "/fragment@2:target:0";
		gpio = "/fragment@2/__overlay__/tlv320aic32x4@18:reset-gpios:0\0/fragment@4:target:0";
		sound = "/fragment@3:target:0";
	};

	__local_fixups__ {

		fragment@2 {

			__overlay__ {

				tlv320aic32x4@18 {
					pinctrl-0 = <0x00 0x04>;
					iov-supply = <0x00>;
					ldoin-supply = <0x00>;
				};
			};
		};

		fragment@3 {

			__overlay__ {
				simple-audio-card,bitclock-master = <0x00>;
				simple-audio-card,frame-master = <0x00>;

				simple-audio-card,codec {
					sound-dai = <0x00>;
				};
			};
		};

		__overrides__ {
			alsaname = <0x00>;
		};
	};
};
