/dts-v1/;

/ {
	compatible = "brcm,bcm2835";

	fragment@0 {
		target = <0xffffffff>;

		__overlay__ {
			#address-cells = <0x01>;
			#size-cells = <0x00>;
			status = "okay";

			si446x@0 {
				compatible = "silabs,si446x";
				reg = <0x00>;
				pinctrl-names = "default";
				pinctrl-0 = <0x01>;
				interrupt-parent = <0xffffffff>;
				interrupts = <0x11 0x02>;
				spi-max-frequency = "\0=\t";
				sdn_pin = <0x1b>;
				irq_pin = <0x11>;
				status = "okay";
				phandle = <0x02>;
			};
		};
	};

	fragment@1 {
		target = <0xffffffff>;

		__overlay__ {

			uhf0_pins {
				brcm,pins = <0x11 0x1b>;
				brcm,function = <0x00 0x01>;
				brcm,pull = <0x02 0x00>;
				phandle = <0x01>;
			};
		};
	};

	__overrides__ {
		int_pin = [00 00 00 02 69 6e 74 65 72 72 75 70 74 73 3a 30 00 00 00 00 02 69 72 71 5f 70 69 6e 3a 30 00 00 00 00 01 62 72 63 6d 2c 70 69 6e 73 3a 30 00];
		reset_pin = [00 00 00 02 73 64 6e 5f 70 69 6e 3a 30 00 00 00 00 01 62 72 63 6d 2c 70 69 6e 73 3a 34 00];
		speed = <0x02 0x7370692d 0x6d61782d 0x66726571 0x75656e63 0x793a3000>;
	};

	__symbols__ {
		uhf0 = "/fragment@0/__overlay__/si446x@0";
		uhf0_pins = "/fragment@1/__overlay__/uhf0_pins";
	};

	__fixups__ {
		spi0 = "/fragment@0:target:0";
		gpio = "/fragment@0/__overlay__/si446x@0:interrupt-parent:0\0/fragment@1:target:0";
	};

	__local_fixups__ {

		fragment@0 {

			__overlay__ {

				si446x@0 {
					pinctrl-0 = <0x00>;
				};
			};
		};

		__overrides__ {
			int_pin = <0x00 0x11 0x1f>;
			reset_pin = <0x00 0x0e>;
			speed = <0x00>;
		};
	};
};
