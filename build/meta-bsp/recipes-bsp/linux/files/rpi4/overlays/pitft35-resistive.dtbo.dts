/dts-v1/;

/ {
	compatible = "brcm,bcm2835";

	fragment@0 {
		target = <0xffffffff>;

		__overlay__ {
			status = "okay";
		};
	};

	fragment@1 {
		target = <0xffffffff>;

		__overlay__ {
			status = "disabled";
		};
	};

	fragment@2 {
		target = <0xffffffff>;

		__overlay__ {
			status = "disabled";
		};
	};

	fragment@3 {
		target = <0xffffffff>;

		__overlay__ {

			pitft_pins {
				brcm,pins = <0x18 0x19>;
				brcm,function = <0x00 0x01>;
				brcm,pull = <0x02 0x00>;
				phandle = <0x01>;
			};
		};
	};

	fragment@4 {
		target = <0xffffffff>;

		__overlay__ {
			#address-cells = <0x01>;
			#size-cells = <0x00>;

			pitft@0 {
				compatible = "himax,hx8357d\0adafruit,yx350hv15";
				reg = <0x00>;
				pinctrl-names = "default";
				pinctrl-0 = <0x01>;
				spi-max-frequency = <0x1e84800>;
				rotate = <0x5a>;
				fps = <0x19>;
				bgr;
				buswidth = <0x08>;
				dc-gpios = <0xffffffff 0x19 0x00>;
				debug = <0x00>;
				phandle = <0x03>;
			};

			pitft_ts@1 {
				compatible = "st,stmpe610";
				reg = <0x01>;
				spi-max-frequency = <0x7a120>;
				irq-gpio = <0xffffffff 0x18 0x02>;
				interrupts = <0x18 0x02>;
				interrupt-parent = <0xffffffff>;
				interrupt-controller;

				stmpe_touchscreen {
					compatible = "st,stmpe-ts";
					st,sample-time = <0x04>;
					st,mod-12b = <0x01>;
					st,ref-sel = <0x00>;
					st,adc-freq = <0x02>;
					st,ave-ctrl = <0x03>;
					st,touch-det-delay = <0x04>;
					st,settling = <0x02>;
					st,fraction-z = <0x07>;
					st,i-drive = <0x00>;
				};

				stmpe_gpio {
					#gpio-cells = <0x02>;
					compatible = "st,stmpe-gpio";
					st,norequest-mask = <0x7b>;
					phandle = <0x02>;
				};
			};
		};
	};

	fragment@5 {
		target-path = "/soc";

		__overlay__ {

			backlight {
				compatible = "gpio-backlight";
				gpios = <0x02 0x02 0x00>;
				default-on;
			};
		};
	};

	__overrides__ {
		speed = <0x03 0x7370692d 0x6d61782d 0x66726571 0x75656e63 0x793a3000>;
		rotate = [00 00 00 03 72 6f 74 61 74 65 3a 30 00];
		fps = [00 00 00 03 66 70 73 3a 30 00];
		debug = <0x03 0x64656275 0x673a3000>;
	};

	__symbols__ {
		pitft_pins = "/fragment@3/__overlay__/pitft_pins";
		pitft = "/fragment@4/__overlay__/pitft@0";
		stmpe_gpio = "/fragment@4/__overlay__/pitft_ts@1/stmpe_gpio";
	};

	__fixups__ {
		spi0 = "/fragment@0:target:0\0/fragment@4:target:0";
		spidev0 = "/fragment@1:target:0";
		spidev1 = "/fragment@2:target:0";
		gpio = "/fragment@3:target:0\0/fragment@4/__overlay__/pitft@0:dc-gpios:0\0/fragment@4/__overlay__/pitft_ts@1:irq-gpio:0\0/fragment@4/__overlay__/pitft_ts@1:interrupt-parent:0";
	};

	__local_fixups__ {

		fragment@4 {

			__overlay__ {

				pitft@0 {
					pinctrl-0 = <0x00>;
				};
			};
		};

		fragment@5 {

			__overlay__ {

				backlight {
					gpios = <0x00>;
				};
			};
		};

		__overrides__ {
			speed = <0x00>;
			rotate = <0x00>;
			fps = <0x00>;
			debug = <0x00>;
		};
	};
};
