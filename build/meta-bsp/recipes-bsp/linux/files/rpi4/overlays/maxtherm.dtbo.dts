/dts-v1/;

/ {
	compatible = "brcm,bcm2835";

	fragment@0 {
		target = <0xffffffff>;

		__dormant__ {
			status = "disabled";
		};
	};

	fragment@1 {
		target = <0xffffffff>;

		__dormant__ {
			status = "disabled";
		};
	};

	fragment@2 {
		target-path = "spi1/spidev@0";

		__dormant__ {
			status = "disabled";
		};
	};

	fragment@3 {
		target-path = "spi1/spidev@1";

		__dormant__ {
			status = "disabled";
		};
	};

	fragment@4 {
		target-path = "spi1/spidev@2";

		__dormant__ {
			status = "disabled";
		};
	};

	fragment@5 {
		target-path = "spi2/spidev@0";

		__dormant__ {
			status = "disabled";
		};
	};

	fragment@6 {
		target-path = "spi2/spidev@1";

		__dormant__ {
			status = "disabled";
		};
	};

	fragment@7 {
		target-path = "spi2/spidev@2";

		__dormant__ {
			status = "disabled";
		};
	};

	fragment@8 {
		target = <0xffffffff>;
		phandle = <0x02>;

		__overlay__ {
			status = "okay";
			#address-cells = <0x01>;
			#size-cells = <0x00>;

			maxtherm@0 {
				compatible = "maxim,max6675";
				reg = <0x00>;
				spi-max-frequency = <0x7a120>;
				phandle = <0x01>;
			};
		};
	};

	fragment@9 {
		target = <0x01>;

		__dormant__ {
			compatible = "maxim,max31855e\0maxim,max31855";
		};
	};

	fragment@10 {
		target = <0x01>;

		__dormant__ {
			compatible = "maxim,max31855j\0maxim,max31855";
		};
	};

	fragment@11 {
		target = <0x01>;

		__dormant__ {
			compatible = "maxim,max31855k\0maxim,max31855";
		};
	};

	fragment@12 {
		target = <0x01>;

		__dormant__ {
			compatible = "maxim,max31855n\0maxim,max31855";
		};
	};

	fragment@13 {
		target = <0x01>;

		__dormant__ {
			compatible = "maxim,max31855r\0maxim,max31855";
		};
	};

	fragment@14 {
		target = <0x01>;

		__dormant__ {
			compatible = "maxim,max31855s\0maxim,max31855";
		};
	};

	fragment@15 {
		target = <0x01>;

		__dormant__ {
			compatible = "maxim,max31855t\0maxim,max31855";
		};
	};

	fragment@16 {
		target = <0x01>;

		__dormant__ {
			compatible = "maxim,max31856";
			spi-cpha;
			thermocouple-type = <0x03>;
		};
	};

	__overrides__ {
		spi0-0 = [00 00 00 00 2b 30 00 00 00 00 02 74 61 72 67 65 74 3a 30 3d 00 ff ff ff ff 00 00 00 01 72 65 67 3a 30 3d 30 00];
		spi0-1 = [00 00 00 00 2b 31 00 00 00 00 02 74 61 72 67 65 74 3a 30 3d 00 ff ff ff ff 00 00 00 01 72 65 67 3a 30 3d 31 00];
		spi1-0 = [00 00 00 00 2b 32 00 00 00 00 02 74 61 72 67 65 74 3a 30 3d 00 ff ff ff ff 00 00 00 01 72 65 67 3a 30 3d 30 00];
		spi1-1 = [00 00 00 00 2b 33 00 00 00 00 02 74 61 72 67 65 74 3a 30 3d 00 ff ff ff ff 00 00 00 01 72 65 67 3a 30 3d 31 00];
		spi1-2 = [00 00 00 00 2b 34 00 00 00 00 02 74 61 72 67 65 74 3a 30 3d 00 ff ff ff ff 00 00 00 01 72 65 67 3a 30 3d 32 00];
		spi2-0 = [00 00 00 00 2b 35 00 00 00 00 02 74 61 72 67 65 74 3a 30 3d 00 ff ff ff ff 00 00 00 01 72 65 67 3a 30 3d 30 00];
		spi2-1 = [00 00 00 00 2b 36 00 00 00 00 02 74 61 72 67 65 74 3a 30 3d 00 ff ff ff ff 00 00 00 01 72 65 67 3a 30 3d 31 00];
		spi2-2 = [00 00 00 00 2b 37 00 00 00 00 02 74 61 72 67 65 74 3a 30 3d 00 ff ff ff ff 00 00 00 01 72 65 67 3a 30 3d 32 00];
		max6675 = [00 00 00 01 63 6f 6d 70 61 74 69 62 6c 65 3d 6d 61 78 69 6d 2c 6d 61 78 36 36 37 35 00];
		max31855 = [00 00 00 01 63 6f 6d 70 61 74 69 62 6c 65 3d 6d 61 78 69 6d 2c 6d 61 78 33 31 38 35 35 00];
		max31855e = [00 00 00 00 2b 39 00];
		max31855j = <0x00 0x2b313000>;
		max31855k = <0x00 0x2b313100>;
		max31855n = <0x00 0x2b313200>;
		max31855r = <0x00 0x2b313300>;
		max31855s = <0x00 0x2b313400>;
		max31855t = <0x00 0x2b313500>;
		max31856 = <0x00 0x2b313600>;
		type_b = [00 00 00 01 74 68 65 72 6d 6f 63 6f 75 70 6c 65 2d 74 79 70 65 3a 30 3d 00 00 00 00 00];
		type_e = [00 00 00 01 74 68 65 72 6d 6f 63 6f 75 70 6c 65 2d 74 79 70 65 3a 30 3d 00 00 00 00 01];
		type_j = [00 00 00 01 74 68 65 72 6d 6f 63 6f 75 70 6c 65 2d 74 79 70 65 3a 30 3d 00 00 00 00 02];
		type_k = [00 00 00 01 74 68 65 72 6d 6f 63 6f 75 70 6c 65 2d 74 79 70 65 3a 30 3d 00 00 00 00 03];
		type_n = [00 00 00 01 74 68 65 72 6d 6f 63 6f 75 70 6c 65 2d 74 79 70 65 3a 30 3d 00 00 00 00 04];
		type_r = [00 00 00 01 74 68 65 72 6d 6f 63 6f 75 70 6c 65 2d 74 79 70 65 3a 30 3d 00 00 00 00 05];
		type_s = [00 00 00 01 74 68 65 72 6d 6f 63 6f 75 70 6c 65 2d 74 79 70 65 3a 30 3d 00 00 00 00 06];
		type_t = [00 00 00 01 74 68 65 72 6d 6f 63 6f 75 70 6c 65 2d 74 79 70 65 3a 30 3d 00 00 00 00 07];
	};

	__symbols__ {
		maxfrag = "/fragment@8";
		max = "/fragment@8/__overlay__/maxtherm@0";
	};

	__fixups__ {
		spidev0 = "/fragment@0:target:0";
		spidev1 = "/fragment@1:target:0";
		spi0 = "/fragment@8:target:0\0/__overrides__:spi0-0:21\0/__overrides__:spi0-1:21";
		spi1 = "/__overrides__:spi1-0:21\0/__overrides__:spi1-1:21\0/__overrides__:spi1-2:21";
		spi2 = "/__overrides__:spi2-0:21\0/__overrides__:spi2-1:21\0/__overrides__:spi2-2:21";
	};

	__local_fixups__ {

		fragment@9 {
			target = <0x00>;
		};

		fragment@10 {
			target = <0x00>;
		};

		fragment@11 {
			target = <0x00>;
		};

		fragment@12 {
			target = <0x00>;
		};

		fragment@13 {
			target = <0x00>;
		};

		fragment@14 {
			target = <0x00>;
		};

		fragment@15 {
			target = <0x00>;
		};

		fragment@16 {
			target = <0x00>;
		};

		__overrides__ {
			spi0-0 = <0x07 0x19>;
			spi0-1 = <0x07 0x19>;
			spi1-0 = <0x07 0x19>;
			spi1-1 = <0x07 0x19>;
			spi1-2 = <0x07 0x19>;
			spi2-0 = <0x07 0x19>;
			spi2-1 = <0x07 0x19>;
			spi2-2 = <0x07 0x19>;
			max6675 = <0x00>;
			max31855 = <0x00>;
			type_b = <0x00>;
			type_e = <0x00>;
			type_j = <0x00>;
			type_k = <0x00>;
			type_n = <0x00>;
			type_r = <0x00>;
			type_s = <0x00>;
			type_t = <0x00>;
		};
	};
};
