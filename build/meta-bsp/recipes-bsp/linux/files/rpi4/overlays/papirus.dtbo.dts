/dts-v1/;

/ {
	compatible = "brcm,bcm2835";

	fragment@0 {
		target = <0xffffffff>;

		__overlay__ {
			#address-cells = <0x01>;
			#size-cells = <0x00>;
			status = "okay";

			lm75@48 {
				compatible = "lm75b";
				reg = <0x48>;
				status = "okay";
				#thermal-sensor-cells = <0x00>;
				phandle = <0x01>;
			};
		};
	};

	fragment@1 {
		target-path = "/";

		__overlay__ {

			thermal-zones {

				display {
					polling-delay-passive = <0x00>;
					polling-delay = <0x00>;
					thermal-sensors = <0x01>;
				};
			};
		};
	};

	fragment@2 {
		target = <0xffffffff>;

		__overlay__ {
			status = "okay";

			spidev@0 {
				status = "disabled";
			};
		};
	};

	fragment@3 {
		target = <0xffffffff>;

		__overlay__ {

			repaper_pins {
				brcm,pins = <0x0e 0x0f 0x17 0x18 0x19>;
				brcm,function = <0x01 0x01 0x01 0x01 0x00>;
				phandle = <0x02>;
			};
		};
	};

	fragment@4 {
		target = <0xffffffff>;

		__overlay__ {
			#address-cells = <0x01>;
			#size-cells = <0x00>;

			repaper@0 {
				compatible = "not_set";
				reg = <0x00>;
				pinctrl-names = "default";
				pinctrl-0 = <0x02>;
				spi-max-frequency = <0x7a1200>;
				panel-on-gpios = <0xffffffff 0x17 0x00>;
				border-gpios = <0xffffffff 0x0e 0x00>;
				discharge-gpios = <0xffffffff 0x0f 0x00>;
				reset-gpios = <0xffffffff 0x18 0x00>;
				busy-gpios = <0xffffffff 0x19 0x00>;
				repaper-thermal-zone = "display";
				phandle = <0x03>;
			};
		};
	};

	__overrides__ {
		panel = [00 00 00 03 63 6f 6d 70 61 74 69 62 6c 65 00];
		speed = <0x03 0x7370692d 0x6d61782d 0x66726571 0x75656e63 0x793a3000>;
	};

	__symbols__ {
		display_temp = "/fragment@0/__overlay__/lm75@48";
		repaper_pins = "/fragment@3/__overlay__/repaper_pins";
		repaper = "/fragment@4/__overlay__/repaper@0";
	};

	__fixups__ {
		i2c_arm = "/fragment@0:target:0";
		spi0 = "/fragment@2:target:0\0/fragment@4:target:0";
		gpio = "/fragment@3:target:0\0/fragment@4/__overlay__/repaper@0:panel-on-gpios:0\0/fragment@4/__overlay__/repaper@0:border-gpios:0\0/fragment@4/__overlay__/repaper@0:discharge-gpios:0\0/fragment@4/__overlay__/repaper@0:reset-gpios:0\0/fragment@4/__overlay__/repaper@0:busy-gpios:0";
	};

	__local_fixups__ {

		fragment@1 {

			__overlay__ {

				thermal-zones {

					display {
						thermal-sensors = <0x00>;
					};
				};
			};
		};

		fragment@4 {

			__overlay__ {

				repaper@0 {
					pinctrl-0 = <0x00>;
				};
			};
		};

		__overrides__ {
			panel = <0x00>;
			speed = <0x00>;
		};
	};
};
