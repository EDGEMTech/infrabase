/dts-v1/;

/ {
	compatible = "brcm,bcm2835";

	fragment@0 {
		target = <0xffffffff>;

		__overlay__ {
			pinctrl-names = "default";
			pinctrl-0 = <0x01>;
			status = "okay";
		};
	};

	fragment@1 {
		target = <0xffffffff>;

		__overlay__ {

			flash@0 {
				compatible = "brcm,bcm2835-smi-nand";
				smi_handle = <0xffffffff>;
				#address-cells = <0x01>;
				#size-cells = <0x01>;
				status = "okay";
				phandle = <0x02>;

				partition@0 {
					label = "stage2";
					reg = <0x00 0x20000>;
					read-only;
				};

				partition@1 {
					label = "firmware";
					reg = <0x20000 0x1000000>;
					read-only;
				};

				partition@2 {
					label = "root";
					reg = <0x1020000 0x80000000>;
				};
			};
		};
	};

	fragment@2 {
		target = <0xffffffff>;

		__overlay__ {

			smi_pins {
				brcm,pins = <0x00 0x01 0x02 0x03 0x04 0x05 0x06 0x07 0x08 0x09 0x0a 0x0b 0x0c 0x0d 0x0e 0x0f>;
				brcm,function = <0x05 0x05 0x05 0x05 0x05 0x05 0x05 0x05 0x05 0x05 0x05 0x05 0x05 0x05 0x05 0x05>;
				brcm,pull = <0x02 0x02 0x02 0x02 0x02 0x02 0x02 0x02 0x00 0x00 0x00 0x00 0x00 0x00 0x00 0x00>;
				phandle = <0x01>;
			};
		};
	};

	__symbols__ {
		nand = "/fragment@1/__overlay__/flash@0";
		smi_pins = "/fragment@2/__overlay__/smi_pins";
	};

	__fixups__ {
		smi = "/fragment@0:target:0\0/fragment@1/__overlay__/flash@0:smi_handle:0";
		soc = "/fragment@1:target:0";
		gpio = "/fragment@2:target:0";
	};

	__local_fixups__ {

		fragment@0 {

			__overlay__ {
				pinctrl-0 = <0x00>;
			};
		};
	};
};
