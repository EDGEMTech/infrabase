/dts-v1/;

/ {
	compatible = "brcm,bcm2835";

	fragment@0 {
		target = <0xffffffff>;

		__overlay__ {
			#address-cells = <0x01>;
			size-cells = <0x00>;
			status = "okay";

			port {

				endpoint {
					remote-endpoint = <0x01>;
					phandle = <0x02>;
				};
			};
		};
	};

	fragment@1 {
		target = <0xffffffff>;

		__overlay__ {
			#address-cells = <0x01>;
			#size-cells = <0x00>;
			status = "okay";

			lcd@45 {
				compatible = "raspberrypi,7inch-touchscreen-panel";
				reg = <0x45>;

				port {

					endpoint {
						remote-endpoint = <0x02>;
						phandle = <0x01>;
					};
				};
			};
		};
	};

	fragment@2 {
		target = <0xffffffff>;

		__overlay__ {
			status = "okay";
		};
	};

	fragment@3 {
		target = <0xffffffff>;

		__overlay__ {
			status = "okay";
		};
	};

	__symbols__ {
		dsi_out_port = "/fragment@0/__overlay__/port/endpoint";
		panel_dsi_port = "/fragment@1/__overlay__/lcd@45/port/endpoint";
	};

	__fixups__ {
		dsi1 = "/fragment@0:target:0";
		i2c_csi_dsi = "/fragment@1:target:0";
		i2c0if = "/fragment@2:target:0";
		i2c0mux = "/fragment@3:target:0";
	};

	__local_fixups__ {

		fragment@0 {

			__overlay__ {

				port {

					endpoint {
						remote-endpoint = <0x00>;
					};
				};
			};
		};

		fragment@1 {

			__overlay__ {

				lcd@45 {

					port {

						endpoint {
							remote-endpoint = <0x00>;
						};
					};
				};
			};
		};
	};
};
