/dts-v1/;

/ {
	compatible = "brcm,bcm2835";

	fragment@0 {
		target = <0xffffffff>;

		__overlay__ {
			compatible = "simple-audio-card";
			i2s-controller = <0xffffffff>;
			status = "okay";
			simple-audio-card,name = "SuperAudioBoard";
			simple-audio-card,widgets = "Line\0Line In\0Line\0Line Out";
			simple-audio-card,routing = "Line Out\0AOUTA+\0Line Out\0AOUTA-\0Line Out\0AOUTB+\0Line Out\0AOUTB-\0AINA\0Line In\0AINB\0Line In";
			simple-audio-card,format = "i2s";
			simple-audio-card,bitclock-master = <0x01>;
			simple-audio-card,frame-master = <0x01>;

			simple-audio-card,cpu {
				sound-dai = <0xffffffff>;
				dai-tdm-slot-num = <0x02>;
				dai-tdm-slot-width = <0x20>;
			};

			simple-audio-card,codec {
				sound-dai = <0x02>;
				system-clock-frequency = <0x1770000>;
				phandle = <0x01>;
			};
		};
	};

	fragment@1 {
		target = <0xffffffff>;

		__overlay__ {
			status = "okay";
		};
	};

	fragment@2 {
		target = <0xffffffff>;

		__overlay__ {
			#address-cells = <0x01>;
			#size-cells = <0x00>;
			status = "okay";

			cs4271@10 {
				#sound-dai-cells = <0x00>;
				compatible = "cirrus,cs4271";
				reg = <0x10>;
				status = "okay";
				reset-gpio = <0xffffffff 0x1a 0x00>;
				phandle = <0x02>;
			};
		};
	};

	__overrides__ {
		gpiopin = [00 00 00 02 72 65 73 65 74 2d 67 70 69 6f 3a 34 00];
	};

	__symbols__ {
		sound_master = "/fragment@0/__overlay__/simple-audio-card,codec";
		cs4271 = "/fragment@2/__overlay__/cs4271@10";
	};

	__fixups__ {
		sound = "/fragment@0:target:0";
		i2s = "/fragment@0/__overlay__:i2s-controller:0\0/fragment@0/__overlay__/simple-audio-card,cpu:sound-dai:0\0/fragment@1:target:0";
		i2c1 = "/fragment@2:target:0";
		gpio = "/fragment@2/__overlay__/cs4271@10:reset-gpio:0";
	};

	__local_fixups__ {

		fragment@0 {

			__overlay__ {
				simple-audio-card,bitclock-master = <0x00>;
				simple-audio-card,frame-master = <0x00>;

				simple-audio-card,codec {
					sound-dai = <0x00>;
				};
			};
		};

		__overrides__ {
			gpiopin = <0x00>;
		};
	};
};
