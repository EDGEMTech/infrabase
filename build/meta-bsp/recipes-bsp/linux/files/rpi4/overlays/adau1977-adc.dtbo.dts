/dts-v1/;

/ {
	compatible = "brcm,bcm2835";

	fragment@0 {
		target = <0xffffffff>;

		__overlay__ {
			#address-cells = <0x01>;
			#size-cells = <0x00>;
			status = "okay";

			codec@11 {
				compatible = "adi,adau1977";
				reg = <0x11>;
				reset-gpios = <0xffffffff 0x05 0x00>;
				AVDD-supply = <0xffffffff>;
				phandle = <0x01>;
			};
		};
	};

	fragment@1 {
		target = <0xffffffff>;

		__overlay__ {
			status = "okay";
		};
	};

	fragment@2 {
		target = <0xffffffff>;

		__overlay__ {
			compatible = "adi,adau1977-adc";
			i2s-controller = <0xffffffff>;
			status = "okay";
		};
	};

	__symbols__ {
		adau1977 = "/fragment@0/__overlay__/codec@11";
	};

	__fixups__ {
		i2c = "/fragment@0:target:0";
		gpio = "/fragment@0/__overlay__/codec@11:reset-gpios:0";
		vdd_3v3_reg = "/fragment@0/__overlay__/codec@11:AVDD-supply:0";
		i2s = "/fragment@1:target:0\0/fragment@2/__overlay__:i2s-controller:0";
		sound = "/fragment@2:target:0";
	};
};
