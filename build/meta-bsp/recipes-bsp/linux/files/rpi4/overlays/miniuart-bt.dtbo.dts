/dts-v1/;

/ {
	compatible = "brcm,bcm2835";

	fragment@0 {
		target = <0xffffffff>;

		__overlay__ {
			pinctrl-names = "default";
			pinctrl-0 = <0xffffffff>;
			status = "okay";
		};
	};

	fragment@1 {
		target = <0xffffffff>;

		__overlay__ {
			status = "disabled";
		};
	};

	fragment@2 {
		target = <0xffffffff>;

		__overlay__ {
			pinctrl-names = "default";
			pinctrl-0 = <0xffffffff 0xffffffff 0x01>;
			status = "okay";
		};
	};

	fragment@3 {
		target = <0xffffffff>;

		__overlay__ {
			brcm,pins;
			brcm,function;
			brcm,pull;
		};
	};

	fragment@4 {
		target = <0xffffffff>;

		__overlay__ {
			brcm,pins = <0x20 0x21>;
			brcm,function = <0x02>;
			brcm,pull = <0x00 0x02>;
		};
	};

	fragment@5 {
		target = <0xffffffff>;

		__overlay__ {

			fake_bt_cts {
				brcm,pins = <0x1f>;
				brcm,function = <0x01>;
				phandle = <0x01>;
			};
		};
	};

	fragment@6 {
		target-path = "/aliases";

		__overlay__ {
			serial0 = "/soc/serial@7e201000";
			serial1 = "/soc/serial@7e215040";
		};
	};

	fragment@7 {
		target = <0xffffffff>;

		__overlay__ {
			phandle = <0x02>;
		};
	};

	__overrides__ {
		krnbt = [00 00 00 02 73 74 61 74 75 73 00];
	};

	__symbols__ {
		fake_bt_cts = "/fragment@5/__overlay__/fake_bt_cts";
		minibt_frag = "/fragment@7/__overlay__";
	};

	__fixups__ {
		uart0 = "/fragment@0:target:0";
		uart0_pins = "/fragment@0/__overlay__:pinctrl-0:0\0/fragment@3:target:0";
		bt = "/fragment@1:target:0";
		uart1 = "/fragment@2:target:0";
		uart1_pins = "/fragment@2/__overlay__:pinctrl-0:0\0/fragment@4:target:0";
		bt_pins = "/fragment@2/__overlay__:pinctrl-0:4";
		gpio = "/fragment@5:target:0";
		minibt = "/fragment@7:target:0";
	};

	__local_fixups__ {

		fragment@2 {

			__overlay__ {
				pinctrl-0 = <0x08>;
			};
		};

		__overrides__ {
			krnbt = <0x00>;
		};
	};
};
