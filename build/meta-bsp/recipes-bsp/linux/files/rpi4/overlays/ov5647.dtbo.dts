/dts-v1/;

/ {
	compatible = "brcm,bcm2835";

	fragment@0 {
		target = <0xffffffff>;

		__overlay__ {
			#address-cells = <0x01>;
			#size-cells = <0x00>;
			status = "okay";

			ov5647@36 {
				compatible = "ovti,ov5647";
				reg = <0x36>;
				status = "okay";
				pwdn-gpios = <0xffffffff 0x29 0x01 0xffffffff 0x20 0x01>;
				clocks = <0x01>;
				rotation = <0x00>;
				orientation = <0x02>;
				phandle = <0x04>;

				port {

					endpoint {
						remote-endpoint = <0x02>;
						clock-lanes = <0x00>;
						data-lanes = <0x01 0x02>;
						clock-noncontinuous;
						link-frequencies = <0x00 0x11b3dc40>;
						phandle = <0x03>;
					};
				};
			};
		};
	};

	fragment@1 {
		target = <0xffffffff>;

		__overlay__ {
			status = "okay";

			port {

				endpoint {
					remote-endpoint = <0x03>;
					data-lanes = <0x01 0x02>;
					phandle = <0x02>;
				};
			};
		};
	};

	fragment@2 {
		target = <0xffffffff>;

		__overlay__ {
			status = "okay";
		};
	};

	fragment@3 {
		target = <0xffffffff>;

		__overlay__ {
			status = "okay";
		};
	};

	fragment@4 {
		target-path = "/__overrides__";

		__overlay__ {
			cam0-pwdn-ctrl = [00 00 00 04 70 77 64 6e 2d 67 70 69 6f 73 3a 30 00];
			cam0-pwdn = [00 00 00 04 70 77 64 6e 2d 67 70 69 6f 73 3a 34 00];
			cam0-led-ctrl = [00 00 00 04 70 77 64 6e 2d 67 70 69 6f 73 3a 31 32 00];
			cam0-led = [00 00 00 04 70 77 64 6e 2d 67 70 69 6f 73 3a 31 36 00];
		};
	};

	fragment@5 {
		target-path = "/";

		__overlay__ {

			camera-clk {
				compatible = "fixed-clock";
				#clock-cells = <0x00>;
				clock-frequency = <0x17d7840>;
				phandle = <0x01>;
			};
		};
	};

	__overrides__ {
		rotation = [00 00 00 04 72 6f 74 61 74 69 6f 6e 3a 30 00];
		orientation = [00 00 00 04 6f 72 69 65 6e 74 61 74 69 6f 6e 3a 30 00];
	};

	__symbols__ {
		ov5647 = "/fragment@0/__overlay__/ov5647@36";
		ov5647_0 = "/fragment@0/__overlay__/ov5647@36/port/endpoint";
		csi1_ep = "/fragment@1/__overlay__/port/endpoint";
		ov5647_clk = "/fragment@5/__overlay__/camera-clk";
	};

	__fixups__ {
		i2c_csi_dsi = "/fragment@0:target:0";
		gpio = "/fragment@0/__overlay__/ov5647@36:pwdn-gpios:0\0/fragment@0/__overlay__/ov5647@36:pwdn-gpios:12";
		csi1 = "/fragment@1:target:0";
		i2c0if = "/fragment@2:target:0";
		i2c0mux = "/fragment@3:target:0";
	};

	__local_fixups__ {

		fragment@0 {

			__overlay__ {

				ov5647@36 {
					clocks = <0x00>;

					port {

						endpoint {
							remote-endpoint = <0x00>;
						};
					};
				};
			};
		};

		fragment@1 {

			__overlay__ {

				port {

					endpoint {
						remote-endpoint = <0x00>;
					};
				};
			};
		};

		fragment@4 {

			__overlay__ {
				cam0-pwdn-ctrl = <0x00>;
				cam0-pwdn = <0x00>;
				cam0-led-ctrl = <0x00>;
				cam0-led = <0x00>;
			};
		};

		__overrides__ {
			rotation = <0x00>;
			orientation = <0x00>;
		};
	};
};
