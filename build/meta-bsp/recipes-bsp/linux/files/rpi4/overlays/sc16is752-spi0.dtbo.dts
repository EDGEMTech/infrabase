/dts-v1/;

/ {
	compatible = "brcm,bcm2835";

	fragment@0 {
		target = <0xffffffff>;

		__overlay__ {
			#address-cells = <0x01>;
			#size-cells = <0x00>;
			status = "okay";

			sc16is752@0 {
				compatible = "nxp,sc16is752";
				reg = <0x00>;
				clocks = <0x01>;
				interrupt-parent = <0xffffffff>;
				interrupts = <0x18 0x02>;
				gpio-controller;
				#gpio-cells = <0x02>;
				spi-max-frequency = "\0=\t";
				phandle = <0x02>;
			};
		};
	};

	fragment@1 {
		target = <0xffffffff>;

		__overlay__ {
			status = "disabled";
		};
	};

	fragment@2 {
		target-path = "/";

		__overlay__ {

			sc16is752_spi0_0_clk {
				compatible = "fixed-clock";
				#clock-cells = <0x00>;
				clock-frequency = <0xe10000>;
				phandle = <0x01>;
			};
		};
	};

	__overrides__ {
		int_pin = [00 00 00 02 69 6e 74 65 72 72 75 70 74 73 3a 30 00];
		xtal = [00 00 00 01 63 6c 6f 63 6b 2d 66 72 65 71 75 65 6e 63 79 3a 30 00];
	};

	__symbols__ {
		sc16is752 = "/fragment@0/__overlay__/sc16is752@0";
		sc16is752_clk = "/fragment@2/__overlay__/sc16is752_spi0_0_clk";
	};

	__fixups__ {
		spi0 = "/fragment@0:target:0";
		gpio = "/fragment@0/__overlay__/sc16is752@0:interrupt-parent:0";
		spidev0 = "/fragment@1:target:0";
	};

	__local_fixups__ {

		fragment@0 {

			__overlay__ {

				sc16is752@0 {
					clocks = <0x00>;
				};
			};
		};

		__overrides__ {
			int_pin = <0x00>;
			xtal = <0x00>;
		};
	};
};
