/dts-v1/;

/ {
	compatible = "brcm,bcm2835";

	fragment@0 {
		target = <0xffffffff>;

		__overlay__ {
			status = "okay";

			spidev@0 {
				status = "disabled";
			};

			spidev@1 {
				status = "disabled";
			};
		};
	};

	fragment@1 {
		target = <0xffffffff>;

		__overlay__ {

			rpi_display_pins {
				brcm,pins = <0x0c 0x17 0x18 0x19>;
				brcm,function = <0x01 0x01 0x01 0x00>;
				brcm,pull = <0x00 0x00 0x00 0x02>;
				phandle = <0x01>;
			};
		};
	};

	fragment@2 {
		target = <0xffffffff>;

		__overlay__ {
			#address-cells = <0x01>;
			#size-cells = <0x00>;

			rpi-display@0 {
				compatible = "ilitek,ili9341";
				reg = <0x00>;
				pinctrl-names = "default";
				pinctrl-0 = <0x01>;
				spi-max-frequency = <0x1e84800>;
				rotate = <0x5a>;
				bgr;
				fps = <0x1e>;
				buswidth = <0x08>;
				reset-gpios = <0xffffffff 0x17 0x01>;
				dc-gpios = <0xffffffff 0x18 0x00>;
				led-gpios = <0xffffffff 0x0c 0x00>;
				debug = <0x00>;
				phandle = <0x03>;
			};

			rpi-display-ts@1 {
				compatible = "ti,ads7846";
				reg = <0x01>;
				spi-max-frequency = <0x1e8480>;
				interrupts = <0x19 0x02>;
				interrupt-parent = <0xffffffff>;
				pendown-gpio = <0xffffffff 0x19 0x01>;
				ti,x-plate-ohms = [00 3c];
				ti,pressure-max = [00 ff];
				phandle = <0x05>;
			};
		};
	};

	fragment@3 {
		target-path = "/";

		__overlay__ {

			lirc_rpi {
				compatible = "rpi,lirc-rpi";
				pinctrl-names = "default";
				pinctrl-0 = <0x02>;
				status = "okay";
				rpi,sense = <0xffffffff>;
				rpi,softcarrier = <0x01>;
				rpi,invert = <0x00>;
				rpi,debug = <0x00>;
				phandle = <0x04>;
			};
		};
	};

	fragment@4 {
		target = <0xffffffff>;

		__overlay__ {

			lirc_pins {
				brcm,pins = <0x06 0x05>;
				brcm,function = <0x01 0x00>;
				brcm,pull = <0x00 0x01>;
				phandle = <0x02>;
			};
		};
	};

	__overrides__ {
		speed = <0x03 0x7370692d 0x6d61782d 0x66726571 0x75656e63 0x793a3000>;
		rotate = [00 00 00 03 72 6f 74 61 74 65 3a 30 00];
		fps = [00 00 00 03 66 70 73 3a 30 00];
		debug = <0x03 0x64656275 0x673a3000 0x04 0x7270692c 0x64656275 0x673a3000>;
		xohms = [00 00 00 05 74 69 2c 78 2d 70 6c 61 74 65 2d 6f 68 6d 73 3b 30 00];
		swapxy = <0x05 0x74692c73 0x7761702d 0x78793f00>;
		backlight = <0x03 0x6c65642d 0x6770696f 0x733a3400 0x01 0x6272636d 0x2c70696e 0x733a3000>;
		gpio_out_pin = <0x02 0x6272636d 0x2c70696e 0x733a3000>;
		gpio_in_pin = <0x02 0x6272636d 0x2c70696e 0x733a3400>;
		gpio_in_pull = <0x02 0x6272636d 0x2c70756c 0x6c3a3400>;
		sense = <0x04 0x7270692c 0x73656e73 0x653a3000>;
		softcarrier = [00 00 00 04 72 70 69 2c 73 6f 66 74 63 61 72 72 69 65 72 3a 30 00];
		invert = [00 00 00 04 72 70 69 2c 69 6e 76 65 72 74 3a 30 00];
	};

	__symbols__ {
		rpi_display_pins = "/fragment@1/__overlay__/rpi_display_pins";
		rpidisplay = "/fragment@2/__overlay__/rpi-display@0";
		rpidisplay_ts = "/fragment@2/__overlay__/rpi-display-ts@1";
		lirc_rpi = "/fragment@3/__overlay__/lirc_rpi";
		lirc_pins = "/fragment@4/__overlay__/lirc_pins";
	};

	__fixups__ {
		spi0 = "/fragment@0:target:0\0/fragment@2:target:0";
		gpio = "/fragment@1:target:0\0/fragment@2/__overlay__/rpi-display@0:reset-gpios:0\0/fragment@2/__overlay__/rpi-display@0:dc-gpios:0\0/fragment@2/__overlay__/rpi-display@0:led-gpios:0\0/fragment@2/__overlay__/rpi-display-ts@1:interrupt-parent:0\0/fragment@2/__overlay__/rpi-display-ts@1:pendown-gpio:0\0/fragment@4:target:0";
	};

	__local_fixups__ {

		fragment@2 {

			__overlay__ {

				rpi-display@0 {
					pinctrl-0 = <0x00>;
				};
			};
		};

		fragment@3 {

			__overlay__ {

				lirc_rpi {
					pinctrl-0 = <0x00>;
				};
			};
		};

		__overrides__ {
			speed = <0x00>;
			rotate = <0x00>;
			fps = <0x00>;
			debug = <0x00 0x0c>;
			xohms = <0x00>;
			swapxy = <0x00>;
			backlight = <0x00 0x10>;
			gpio_out_pin = <0x00>;
			gpio_in_pin = <0x00>;
			gpio_in_pull = <0x00>;
			sense = <0x00>;
			softcarrier = <0x00>;
			invert = <0x00>;
		};
	};
};
