/dts-v1/;

/ {
	compatible = "brcm,bcm2835";

	fragment@0 {
		target = <0xffffffff>;

		__overlay__ {
			pinctrl-names = "default";
			pinctrl-0 = <0x01>;
			status = "okay";
		};
	};

	fragment@1 {
		target = <0xffffffff>;

		__overlay__ {

			uart0_pins {
				brcm,pins = <0x0e 0x0f>;
				brcm,function = <0x04>;
				brcm,pull = <0x00 0x02>;
				phandle = <0x01>;
			};
		};
	};

	__overrides__ {
		txd0_pin = <0x01 0x6272636d 0x2c70696e 0x733a3000>;
		rxd0_pin = <0x01 0x6272636d 0x2c70696e 0x733a3400>;
		pin_func = <0x01 0x6272636d 0x2c66756e 0x6374696f 0x6e3a3000>;
	};

	__symbols__ {
		uart0_pins = "/fragment@1/__overlay__/uart0_pins";
	};

	__fixups__ {
		uart0 = "/fragment@0:target:0";
		gpio = "/fragment@1:target:0";
	};

	__local_fixups__ {

		fragment@0 {

			__overlay__ {
				pinctrl-0 = <0x00>;
			};
		};

		__overrides__ {
			txd0_pin = <0x00>;
			rxd0_pin = <0x00>;
			pin_func = <0x00>;
		};
	};
};
