/dts-v1/;

/ {
	compatible = "brcm,bcm2711";

	fragment@0 {
		target = <0xffffffff>;

		__overlay__ {
			pinctrl-names = "default";
			pinctrl-0 = <0xffffffff>;
			status = "okay";
		};
	};

	fragment@1 {
		target = <0xffffffff>;

		__dormant__ {
			brcm,pins = <0x04 0x05 0x06 0x07>;
			brcm,pull = <0x00 0x02 0x02 0x00>;
		};
	};

	__overrides__ {
		ctsrts = [00 00 00 00 3d 31 00];
	};

	__fixups__ {
		uart3 = "/fragment@0:target:0";
		uart3_pins = "/fragment@0/__overlay__:pinctrl-0:0\0/fragment@1:target:0";
	};
};
