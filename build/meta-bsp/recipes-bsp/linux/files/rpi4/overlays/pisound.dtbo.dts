/dts-v1/;

/ {
	compatible = "brcm,bcm2835";

	fragment@0 {
		target = <0xffffffff>;

		__overlay__ {
			status = "okay";
		};
	};

	fragment@1 {
		target = <0xffffffff>;

		__overlay__ {
			status = "disabled";
		};
	};

	fragment@2 {
		target = <0xffffffff>;

		__overlay__ {
			status = "okay";
		};
	};

	fragment@3 {
		target = <0xffffffff>;

		__overlay__ {
			#address-cells = <0x01>;
			#size-cells = <0x00>;

			pisound_spi@0 {
				compatible = "blokaslabs,pisound-spi";
				reg = <0x00>;
				pinctrl-names = "default";
				pinctrl-0 = <0xffffffff>;
				spi-max-frequency = <0xf4240>;
				phandle = <0x02>;
			};
		};
	};

	fragment@4 {
		target-path = "/";

		__overlay__ {

			pcm5102a-codec {
				#sound-dai-cells = <0x00>;
				compatible = "ti,pcm5102a";
				status = "okay";
			};
		};
	};

	fragment@5 {
		target = <0xffffffff>;

		__overlay__ {
			compatible = "blokaslabs,pisound";
			i2s-controller = <0xffffffff>;
			status = "okay";
			pinctrl-0 = <0x01>;
			osr-gpios = <0xffffffff 0x0d 0x00 0xffffffff 0x1a 0x00 0xffffffff 0x10 0x00>;
			reset-gpios = <0xffffffff 0x0c 0x00 0xffffffff 0x18 0x00>;
			data_available-gpios = <0xffffffff 0x19 0x00>;
			button-gpios = <0xffffffff 0x11 0x01>;
		};
	};

	fragment@6 {
		target = <0xffffffff>;

		__overlay__ {
			pinctrl-names = "default";
			pinctrl-0 = <0x01>;

			pisound_button_pins {
				brcm,pins = <0x11>;
				brcm,function = <0x00>;
				brcm,pull = <0x02>;
				phandle = <0x01>;
			};
		};
	};

	fragment@7 {
		target = <0xffffffff>;

		__overlay__ {
			status = "okay";
		};
	};

	__symbols__ {
		pisound_spi = "/fragment@3/__overlay__/pisound_spi@0";
		pisound_button_pins = "/fragment@6/__overlay__/pisound_button_pins";
	};

	__fixups__ {
		spi0 = "/fragment@0:target:0\0/fragment@3:target:0";
		spidev0 = "/fragment@1:target:0";
		spidev1 = "/fragment@2:target:0";
		spi0_pins = "/fragment@3/__overlay__/pisound_spi@0:pinctrl-0:0";
		sound = "/fragment@5:target:0";
		i2s = "/fragment@5/__overlay__:i2s-controller:0\0/fragment@7:target:0";
		gpio = "/fragment@5/__overlay__:osr-gpios:0\0/fragment@5/__overlay__:osr-gpios:12\0/fragment@5/__overlay__:osr-gpios:24\0/fragment@5/__overlay__:reset-gpios:0\0/fragment@5/__overlay__:reset-gpios:12\0/fragment@5/__overlay__:data_available-gpios:0\0/fragment@5/__overlay__:button-gpios:0\0/fragment@6:target:0";
	};

	__local_fixups__ {

		fragment@5 {

			__overlay__ {
				pinctrl-0 = <0x00>;
			};
		};

		fragment@6 {

			__overlay__ {
				pinctrl-0 = <0x00>;
			};
		};
	};
};
