/dts-v1/;

/ {
	compatible = "brcm,bcm2835";

	fragment@0 {
		target-path = "/";

		__overlay__ {

			rpi_backlight {
				compatible = "raspberrypi,rpi-backlight";
				firmware = <0xffffffff>;
				status = "okay";
				phandle = <0x01>;
			};
		};
	};

	__symbols__ {
		rpi_backlight = "/fragment@0/__overlay__/rpi_backlight";
	};

	__fixups__ {
		firmware = "/fragment@0/__overlay__/rpi_backlight:firmware:0";
	};
};
