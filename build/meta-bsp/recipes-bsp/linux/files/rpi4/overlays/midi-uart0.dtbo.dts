/dts-v1/;

/ {
	compatible = "brcm,bcm2835";

	fragment@0 {
		target-path = "/";

		__overlay__ {

			midi_clk {
				compatible = "fixed-clock";
				#clock-cells = <0x00>;
				clock-output-names = "uart0_pclk";
				clock-frequency = <0x3840000>;
				phandle = <0x01>;
			};
		};
	};

	fragment@1 {
		target = <0xffffffff>;

		__overlay__ {
			clocks = <0x01 0xffffffff 0x14>;
		};
	};

	__symbols__ {
		midi_clk = "/fragment@0/__overlay__/midi_clk";
	};

	__fixups__ {
		uart0 = "/fragment@1:target:0";
		clocks = "/fragment@1/__overlay__:clocks:4";
	};

	__local_fixups__ {

		fragment@1 {

			__overlay__ {
				clocks = <0x00>;
			};
		};
	};
};
