/dts-v1/;

/ {
	compatible = "brcm,bcm2835";

	fragment@0 {
		target = <0xffffffff>;

		__overlay__ {
			status = "okay";
		};
	};

	fragment@1 {
		target-path = "/";

		__overlay__ {

			tc358743-codec {
				#sound-dai-cells = <0x00>;
				compatible = "linux,spdif-dir";
				status = "okay";
				phandle = <0x02>;
			};
		};
	};

	fragment@2 {
		target = <0xffffffff>;

		__overlay__ {
			compatible = "simple-audio-card";
			simple-audio-card,format = "i2s";
			simple-audio-card,name = "tc358743";
			simple-audio-card,bitclock-master = <0x01>;
			simple-audio-card,frame-master = <0x01>;
			status = "okay";
			phandle = <0x03>;

			simple-audio-card,cpu {
				sound-dai = <0xffffffff>;
				dai-tdm-slot-num = <0x02>;
				dai-tdm-slot-width = <0x20>;
			};

			simple-audio-card,codec {
				sound-dai = <0x02>;
				phandle = <0x01>;
			};
		};
	};

	__overrides__ {
		card-name = [00 00 00 03 73 69 6d 70 6c 65 2d 61 75 64 69 6f 2d 63 61 72 64 2c 6e 61 6d 65 00];
	};

	__symbols__ {
		tc358743_codec = "/fragment@1/__overlay__/tc358743-codec";
		sound_overlay = "/fragment@2/__overlay__";
		dailink0_slave = "/fragment@2/__overlay__/simple-audio-card,codec";
	};

	__fixups__ {
		i2s = "/fragment@0:target:0\0/fragment@2/__overlay__/simple-audio-card,cpu:sound-dai:0";
		sound = "/fragment@2:target:0";
	};

	__local_fixups__ {

		fragment@2 {

			__overlay__ {
				simple-audio-card,bitclock-master = <0x00>;
				simple-audio-card,frame-master = <0x00>;

				simple-audio-card,codec {
					sound-dai = <0x00>;
				};
			};
		};

		__overrides__ {
			card-name = <0x00>;
		};
	};
};
