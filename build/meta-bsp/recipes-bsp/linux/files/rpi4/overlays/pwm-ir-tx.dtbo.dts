/dts-v1/;

/ {
	compatible = "brcm,bcm2835";

	fragment@0 {
		target = <0xffffffff>;

		__overlay__ {

			pwm0_pins {
				brcm,pins = <0x12>;
				brcm,function = <0x02>;
				phandle = <0x01>;
			};
		};
	};

	fragment@1 {
		target = <0xffffffff>;

		__overlay__ {
			pinctrl-names = "default";
			pinctrl-0 = <0x01>;
			status = "okay";
		};
	};

	fragment@2 {
		target-path = "/";

		__overlay__ {

			pwm-ir-transmitter {
				compatible = "pwm-ir-tx";
				pwms = <0xffffffff 0x00 0x64>;
			};
		};
	};

	__overrides__ {
		gpio_pin = <0x01 0x6272636d 0x2c70696e 0x733a3000>;
		func = <0x01 0x6272636d 0x2c66756e 0x6374696f 0x6e3a3000>;
	};

	__symbols__ {
		pwm0_pins = "/fragment@0/__overlay__/pwm0_pins";
	};

	__fixups__ {
		gpio = "/fragment@0:target:0";
		pwm = "/fragment@1:target:0\0/fragment@2/__overlay__/pwm-ir-transmitter:pwms:0";
	};

	__local_fixups__ {

		fragment@1 {

			__overlay__ {
				pinctrl-0 = <0x00>;
			};
		};

		__overrides__ {
			gpio_pin = <0x00>;
			func = <0x00>;
		};
	};
};
