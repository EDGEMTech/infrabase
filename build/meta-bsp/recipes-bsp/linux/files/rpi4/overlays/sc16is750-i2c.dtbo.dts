/dts-v1/;

/ {
	compatible = "brcm,bcm2835";

	fragment@0 {
		target = <0xffffffff>;

		__overlay__ {
			#address-cells = <0x01>;
			#size-cells = <0x00>;
			status = "okay";

			sc16is750@48 {
				compatible = "nxp,sc16is750";
				reg = <0x48>;
				clocks = <0x01>;
				interrupt-parent = <0xffffffff>;
				interrupts = <0x18 0x02>;
				gpio-controller;
				#gpio-cells = <0x02>;
				i2c-max-frequency = <0x61a80>;
				phandle = <0x02>;
			};
		};
	};

	fragment@1 {
		target-path = "/";

		__overlay__ {

			sc16is750_i2c_clk@48 {
				compatible = "fixed-clock";
				#clock-cells = <0x00>;
				clock-frequency = <0xe10000>;
				phandle = <0x01>;
			};
		};
	};

	__overrides__ {
		int_pin = [00 00 00 02 69 6e 74 65 72 72 75 70 74 73 3a 30 00];
		addr = [00 00 00 02 72 65 67 3a 30 00 00 00 00 01 6e 61 6d 65 00];
		xtal = [00 00 00 01 63 6c 6f 63 6b 2d 66 72 65 71 75 65 6e 63 79 3a 30 00];
	};

	__symbols__ {
		sc16is750 = "/fragment@0/__overlay__/sc16is750@48";
		sc16is750_clk = "/fragment@1/__overlay__/sc16is750_i2c_clk@48";
	};

	__fixups__ {
		i2c_arm = "/fragment@0:target:0";
		gpio = "/fragment@0/__overlay__/sc16is750@48:interrupt-parent:0";
	};

	__local_fixups__ {

		fragment@0 {

			__overlay__ {

				sc16is750@48 {
					clocks = <0x00>;
				};
			};
		};

		__overrides__ {
			int_pin = <0x00>;
			addr = <0x00 0x0a>;
			xtal = <0x00>;
		};
	};
};
