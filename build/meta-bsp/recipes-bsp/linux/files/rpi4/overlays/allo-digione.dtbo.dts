/dts-v1/;

/ {
	compatible = "brcm,bcm2835";

	fragment@0 {
		target = <0xffffffff>;

		__overlay__ {
			status = "okay";
		};
	};

	fragment@1 {
		target = <0xffffffff>;

		__overlay__ {
			#address-cells = <0x01>;
			#size-cells = <0x00>;
			status = "okay";

			wm8804@3b {
				#sound-dai-cells = <0x00>;
				compatible = "wlf,wm8804";
				reg = <0x3b>;
				PVDD-supply = <0xffffffff>;
				DVDD-supply = <0xffffffff>;
				status = "okay";
				wlf,reset-gpio = <0xffffffff 0x11 0x00>;
			};
		};
	};

	fragment@2 {
		target = <0xffffffff>;

		__overlay__ {
			compatible = "allo,allo-digione";
			i2s-controller = <0xffffffff>;
			status = "okay";
			clock44-gpio = <0xffffffff 0x05 0x00>;
			clock48-gpio = <0xffffffff 0x06 0x00>;
		};
	};

	__fixups__ {
		i2s = "/fragment@0:target:0\0/fragment@2/__overlay__:i2s-controller:0";
		i2c1 = "/fragment@1:target:0";
		vdd_3v3_reg = "/fragment@1/__overlay__/wm8804@3b:PVDD-supply:0\0/fragment@1/__overlay__/wm8804@3b:DVDD-supply:0";
		gpio = "/fragment@1/__overlay__/wm8804@3b:wlf,reset-gpio:0\0/fragment@2/__overlay__:clock44-gpio:0\0/fragment@2/__overlay__:clock48-gpio:0";
		sound = "/fragment@2:target:0";
	};
};
