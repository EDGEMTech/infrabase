/dts-v1/;

/ {
	compatible = "brcm,bcm2835";

	fragment@0 {
		target = <0xffffffff>;

		__overlay__ {
			pinctrl-names = "default";
			pinctrl-0 = <0x01>;
			bus-width = <0x04>;
			brcm,overclock-50 = <0x23>;
			status = "okay";
		};
	};

	fragment@1 {
		target = <0xffffffff>;

		__overlay__ {

			sdio_pins {
				brcm,pins = <0x22 0x23 0x24 0x25 0x26 0x27>;
				brcm,function = <0x07>;
				brcm,pull = <0x00 0x02 0x02 0x02 0x02 0x02>;
				phandle = <0x01>;
			};

			power_ctrl_pins {
				brcm,pins = <0x28>;
				brcm,function = <0x01>;
				phandle = <0x02>;
			};
		};
	};

	fragment@2 {
		target-path = "/";

		__overlay__ {

			power_ctrl {
				compatible = "gpio-poweroff";
				gpios = <0xffffffff 0x28 0x01>;
				force;
				pinctrl-names = "default";
				pinctrl-0 = <0x02>;
				phandle = <0x04>;
			};

			i2c@0 {
				compatible = "i2c-gpio";
				gpios = <0xffffffff 0x2b 0x06 0xffffffff 0x2a 0x06>;
				i2c-gpio,delay-us = <0x05>;
				i2c-gpio,scl-open-drain;
				i2c-gpio,sda-open-drain;
				#address-cells = <0x01>;
				#size-cells = <0x00>;
				phandle = <0x03>;
			};

			sd8xxx-wlan {
				drvdbg = <0x06>;
				drv_mode = <0x01>;
				cfg80211_wext = <0x0f>;
				sta_name = "wlan";
				wfd_name = "p2p";
				cal_data_cfg = "none";
			};
		};
	};

	fragment@3 {
		target = <0x03>;

		__overlay__ {
			#address-cells = <0x01>;
			#size-cells = <0x00>;
			status = "okay";

			gpio_expander@20 {
				compatible = "nxp,pca9554";
				gpio-controller;
				#gpio-cells = <0x02>;
				reg = <0x20>;
				status = "okay";
				phandle = <0x05>;
			};

			ds1307@68 {
				compatible = "dallas,ds1307";
				reg = <0x68>;
				status = "okay";
				phandle = <0x06>;
			};

			pca9633@62 {
				compatible = "nxp,pca9633";
				reg = <0x62>;
				#address-cells = <0x01>;
				#size-cells = <0x00>;
				phandle = <0x07>;

				red@0 {
					label = "red";
					reg = <0x00>;
					linux,default-trigger = "none";
				};

				green@1 {
					label = "green";
					reg = <0x01>;
					linux,default-trigger = "none";
				};

				blue@2 {
					label = "blue";
					reg = <0x02>;
					linux,default-trigger = "none";
				};

				unused@3 {
					label = "unused";
					reg = <0x03>;
					linux,default-trigger = "none";
				};
			};
		};
	};

	__symbols__ {
		sdio_pins = "/fragment@1/__overlay__/sdio_pins";
		power_ctrl_pins = "/fragment@1/__overlay__/power_ctrl_pins";
		power_ctrl = "/fragment@2/__overlay__/power_ctrl";
		i2c_soft = "/fragment@2/__overlay__/i2c@0";
		gpio_expander = "/fragment@3/__overlay__/gpio_expander@20";
		ds1307 = "/fragment@3/__overlay__/ds1307@68";
		pca9633 = "/fragment@3/__overlay__/pca9633@62";
	};

	__fixups__ {
		mmcnr = "/fragment@0:target:0";
		gpio = "/fragment@1:target:0\0/fragment@2/__overlay__/power_ctrl:gpios:0\0/fragment@2/__overlay__/i2c@0:gpios:0\0/fragment@2/__overlay__/i2c@0:gpios:12";
	};

	__local_fixups__ {

		fragment@0 {

			__overlay__ {
				pinctrl-0 = <0x00>;
			};
		};

		fragment@2 {

			__overlay__ {

				power_ctrl {
					pinctrl-0 = <0x00>;
				};
			};
		};

		fragment@3 {
			target = <0x00>;
		};
	};
};
