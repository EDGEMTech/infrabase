/dts-v1/;

/ {
	compatible = "brcm,bcm2835";

	fragment@0 {
		target = <0xffffffff>;

		__overlay__ {
			status = "okay";
			#address-cells = <0x01>;
			#size-cells = <0x00>;

			oled@3c {
				compatible = "solomon,ssd1306fb-i2c";
				reg = <0x3c>;
				solomon,width = <0x80>;
				solomon,height = <0x40>;
				solomon,page-offset = <0x00>;
				phandle = <0x01>;
			};
		};
	};

	__overrides__ {
		address = [00 00 00 01 72 65 67 3a 30 00];
		width = <0x01 0x736f6c6f 0x6d6f6e2c 0x77696474 0x683a3000>;
		height = [00 00 00 01 73 6f 6c 6f 6d 6f 6e 2c 68 65 69 67 68 74 3a 30 00];
		offset = [00 00 00 01 73 6f 6c 6f 6d 6f 6e 2c 70 61 67 65 2d 6f 66 66 73 65 74 3a 30 00];
		normal = [00 00 00 01 73 6f 6c 6f 6d 6f 6e 2c 73 65 67 6d 65 6e 74 2d 6e 6f 2d 72 65 6d 61 70 3f 00];
		sequential = [00 00 00 01 73 6f 6c 6f 6d 6f 6e 2c 63 6f 6d 2d 73 65 71 3f 00];
		remapped = [00 00 00 01 73 6f 6c 6f 6d 6f 6e 2c 63 6f 6d 2d 6c 72 72 65 6d 61 70 3f 00];
		inverted = <0x01 0x736f6c6f 0x6d6f6e2c 0x636f6d2d 0x696e7664 0x69723f00>;
	};

	__symbols__ {
		ssd1306 = "/fragment@0/__overlay__/oled@3c";
	};

	__fixups__ {
		i2c1 = "/fragment@0:target:0";
	};

	__local_fixups__ {

		__overrides__ {
			address = <0x00>;
			width = <0x00>;
			height = <0x00>;
			offset = <0x00>;
			normal = <0x00>;
			sequential = <0x00>;
			remapped = <0x00>;
			inverted = <0x00>;
		};
	};
};
