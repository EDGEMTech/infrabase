/dts-v1/;

/ {
	compatible = "brcm,bcm2835";

	fragment@0 {
		target = <0xffffffff>;

		__overlay__ {
			cs-gpios = <0xffffffff 0x24 0x01 0xffffffff 0x23 0x01>;
		};
	};

	fragment@1 {
		target = <0xffffffff>;

		__overlay__ {
			brcm,pins = <0x24 0x23>;
		};
	};

	fragment@2 {
		target = <0xffffffff>;

		__overlay__ {
			brcm,pins = <0x25 0x26 0x27>;
		};
	};

	__fixups__ {
		spi0 = "/fragment@0:target:0";
		gpio = "/fragment@0/__overlay__:cs-gpios:0\0/fragment@0/__overlay__:cs-gpios:12";
		spi0_cs_pins = "/fragment@1:target:0";
		spi0_pins = "/fragment@2:target:0";
	};
};
