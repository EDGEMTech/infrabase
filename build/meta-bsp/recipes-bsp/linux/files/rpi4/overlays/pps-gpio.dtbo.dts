/dts-v1/;

/ {
	compatible = "brcm,bcm2835";

	fragment@0 {
		target-path = "/";

		__overlay__ {

			pps@12 {
				compatible = "pps-gpio";
				pinctrl-names = "default";
				pinctrl-0 = <0x01>;
				gpios = <0xffffffff 0x12 0x00>;
				status = "okay";
				phandle = <0x02>;
			};
		};
	};

	fragment@1 {
		target = <0xffffffff>;

		__overlay__ {

			pps_pins@12 {
				brcm,pins = <0x12>;
				brcm,function = <0x00>;
				brcm,pull = <0x00>;
				phandle = <0x01>;
			};
		};
	};

	__overrides__ {
		gpiopin = <0x02 0x6770696f 0x733a3400 0x02 0x7265673a 0x30000000 0x16272 0x636d2c70 0x696e733a 0x30000000 0x17265 0x673a3000>;
		assert_falling_edge = [00 00 00 02 61 73 73 65 72 74 2d 66 61 6c 6c 69 6e 67 2d 65 64 67 65 3f 00];
		capture_clear = [00 00 00 02 63 61 70 74 75 72 65 2d 63 6c 65 61 72 3f 00];
	};

	__symbols__ {
		pps = "/fragment@0/__overlay__/pps@12";
		pps_pins = "/fragment@1/__overlay__/pps_pins@12";
	};

	__fixups__ {
		gpio = "/fragment@0/__overlay__/pps@12:gpios:0\0/fragment@1:target:0";
	};

	__local_fixups__ {

		fragment@0 {

			__overlay__ {

				pps@12 {
					pinctrl-0 = <0x00>;
				};
			};
		};

		__overrides__ {
			gpiopin = <0x00 0x0c 0x16 0x26>;
			assert_falling_edge = <0x00>;
			capture_clear = <0x00>;
		};
	};
};
