/dts-v1/;

/ {
	compatible = "brcm,bcm2835";

	fragment@0 {
		target = <0xffffffff>;

		__overlay__ {
			interrupts = <0xff 0xff 0x02 0x12>;
		};
	};

	__fixups__ {
		gpio = "/fragment@0:target:0";
	};
};
