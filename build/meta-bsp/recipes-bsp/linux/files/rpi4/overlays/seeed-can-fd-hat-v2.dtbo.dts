/dts-v1/;

/ {
	compatible = "brcm,bcm2835";

	fragment@0 {
		target = <0xffffffff>;

		__overlay__ {
			status = "disabled";
		};
	};

	fragment@1 {
		target = <0xffffffff>;

		__overlay__ {

			mcp251xfd_spi0_0_pins {
				brcm,pins = <0x19>;
				brcm,function = <0x00>;
				phandle = <0x01>;
			};
		};
	};

	fragment@2 {
		target-path = "/clocks";

		__overlay__ {

			mcp251xfd-spi0-0-osc {
				#clock-cells = <0x00>;
				compatible = "fixed-clock";
				clock-frequency = <0x2625a00>;
				phandle = <0x02>;
			};
		};
	};

	fragment@3 {
		target = <0xffffffff>;

		__overlay__ {
			status = "okay";
			#address-cells = <0x01>;
			#size-cells = <0x00>;

			mcp251xfd@0 {
				compatible = "microchip,mcp251xfd";
				reg = <0x00>;
				pinctrl-names = "default";
				pinctrl-0 = <0x01>;
				spi-max-frequency = <0x1312d00>;
				interrupt-parent = <0xffffffff>;
				interrupts = <0x19 0x08>;
				clocks = <0x02>;
			};
		};
	};

	fragment@4 {
		target = <0xffffffff>;

		__overlay__ {
			status = "disabled";
		};
	};

	fragment@5 {
		target = <0xffffffff>;

		__overlay__ {

			mcp251xfd_spi0_1_pins {
				brcm,pins = <0x18>;
				brcm,function = <0x00>;
				phandle = <0x03>;
			};
		};
	};

	fragment@6 {
		target-path = "/clocks";

		__overlay__ {

			mcp251xfd-spi0-1-osc {
				#clock-cells = <0x00>;
				compatible = "fixed-clock";
				clock-frequency = <0x2625a00>;
				phandle = <0x04>;
			};
		};
	};

	fragment@7 {
		target = <0xffffffff>;

		__overlay__ {
			status = "okay";
			#address-cells = <0x01>;
			#size-cells = <0x00>;

			mcp251xfd@1 {
				compatible = "microchip,mcp251xfd";
				reg = <0x01>;
				pinctrl-names = "default";
				pinctrl-0 = <0x03>;
				spi-max-frequency = <0x1312d00>;
				interrupt-parent = <0xffffffff>;
				interrupts = <0x18 0x08>;
				clocks = <0x04>;
			};
		};
	};

	fragment@8 {
		target = <0x05>;

		__overlay__ {
			#address-cells = <0x01>;
			#size-cells = <0x00>;

			pcf85063@51 {
				compatible = "nxp,pcf85063";
				reg = <0x51>;
			};
		};
	};

	fragment@9 {
		target = <0xffffffff>;

		__overlay__ {
			status = "okay";
			phandle = <0x05>;
		};
	};

	__symbols__ {
		mcp251xfd_pins = "/fragment@1/__overlay__/mcp251xfd_spi0_0_pins";
		clk_mcp251xfd_osc = "/fragment@2/__overlay__/mcp251xfd-spi0-0-osc";
		mcp251xfd_pins_1 = "/fragment@5/__overlay__/mcp251xfd_spi0_1_pins";
		clk_mcp251xfd_osc_1 = "/fragment@6/__overlay__/mcp251xfd-spi0-1-osc";
		i2cbus = "/fragment@9/__overlay__";
	};

	__fixups__ {
		spidev0 = "/fragment@0:target:0";
		gpio = "/fragment@1:target:0\0/fragment@3/__overlay__/mcp251xfd@0:interrupt-parent:0\0/fragment@5:target:0\0/fragment@7/__overlay__/mcp251xfd@1:interrupt-parent:0";
		spi0 = "/fragment@3:target:0\0/fragment@7:target:0";
		spidev1 = "/fragment@4:target:0";
		i2c_arm = "/fragment@9:target:0";
	};

	__local_fixups__ {

		fragment@3 {

			__overlay__ {

				mcp251xfd@0 {
					pinctrl-0 = <0x00>;
					clocks = <0x00>;
				};
			};
		};

		fragment@7 {

			__overlay__ {

				mcp251xfd@1 {
					pinctrl-0 = <0x00>;
					clocks = <0x00>;
				};
			};
		};

		fragment@8 {
			target = <0x00>;
		};
	};
};
