/dts-v1/;

/ {
	compatible = "brcm,bcm2835";

	fragment@0 {
		target = <0xffffffff>;
		#address-cells = <0x01>;
		#size-cells = <0x01>;

		__overlay__ {
			compatible = "brcm,bcm2835-usb";
			dr_mode = "otg";
			g-np-tx-fifo-size = <0x20>;
			g-rx-fifo-size = <0x22e>;
			g-tx-fifo-size = <0x200 0x200 0x200 0x200 0x200 0x100 0x100>;
			status = "okay";
			phandle = <0x01>;
		};
	};

	__overrides__ {
		dr_mode = <0x01 0x64725f6d 0x6f646500>;
		g-np-tx-fifo-size = <0x01 0x672d6e70 0x2d74782d 0x6669666f 0x2d73697a 0x653a3000>;
		g-rx-fifo-size = [00 00 00 01 67 2d 72 78 2d 66 69 66 6f 2d 73 69 7a 65 3a 30 00];
	};

	__symbols__ {
		dwc2_usb = "/fragment@0/__overlay__";
	};

	__fixups__ {
		usb = "/fragment@0:target:0";
	};

	__local_fixups__ {

		__overrides__ {
			dr_mode = <0x00>;
			g-np-tx-fifo-size = <0x00>;
			g-rx-fifo-size = <0x00>;
		};
	};
};
