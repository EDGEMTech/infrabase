/dts-v1/;

/ {
	compatible = "brcm,bcm2835";

	fragment@0 {
		target = <0xffffffff>;

		__overlay__ {

			exc3000_pins {
				brcm,pins = <0x04>;
				brcm,function = <0x00>;
				brcm,pull = <0x02>;
				phandle = <0x01>;
			};
		};
	};

	fragment@1 {
		target = <0xffffffff>;

		__overlay__ {
			#address-cells = <0x01>;
			#size-cells = <0x00>;
			status = "okay";

			exc3000@2a {
				compatible = "eeti,exc3000";
				reg = <0x2a>;
				pinctrl-names = "default";
				pinctrl-0 = <0x01>;
				interrupt-parent = <0xffffffff>;
				interrupts = <0x04 0x08>;
				touchscreen-size-x = <0x1000>;
				touchscreen-size-y = <0x1000>;
				phandle = <0x02>;
			};
		};
	};

	__overrides__ {
		interrupt = [00 00 00 01 62 72 63 6d 2c 70 69 6e 73 3a 30 00 00 00 00 02 69 6e 74 65 72 72 75 70 74 73 3a 30 00];
		sizex = [00 00 00 02 74 6f 75 63 68 73 63 72 65 65 6e 2d 73 69 7a 65 2d 78 3a 30 00];
		sizey = [00 00 00 02 74 6f 75 63 68 73 63 72 65 65 6e 2d 73 69 7a 65 2d 79 3a 30 00];
		invx = <0x02 0x746f7563 0x68736372 0x65656e2d 0x696e7665 0x72746564 0x2d783f00>;
		invy = <0x02 0x746f7563 0x68736372 0x65656e2d 0x696e7665 0x72746564 0x2d793f00>;
		swapxy = [00 00 00 02 74 6f 75 63 68 73 63 72 65 65 6e 2d 73 77 61 70 70 65 64 2d 78 2d 79 3f 00];
	};

	__symbols__ {
		exc3000_pins = "/fragment@0/__overlay__/exc3000_pins";
		exc3000 = "/fragment@1/__overlay__/exc3000@2a";
	};

	__fixups__ {
		gpio = "/fragment@0:target:0\0/fragment@1/__overlay__/exc3000@2a:interrupt-parent:0";
		i2c1 = "/fragment@1:target:0";
	};

	__local_fixups__ {

		fragment@1 {

			__overlay__ {

				exc3000@2a {
					pinctrl-0 = <0x00>;
				};
			};
		};

		__overrides__ {
			interrupt = <0x00 0x10>;
			sizex = <0x00>;
			sizey = <0x00>;
			invx = <0x00>;
			invy = <0x00>;
			swapxy = <0x00>;
		};
	};
};
