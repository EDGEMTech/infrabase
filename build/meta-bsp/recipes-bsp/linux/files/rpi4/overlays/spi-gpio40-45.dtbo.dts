/dts-v1/;

/ {
	compatible = "brcm,bcm2835";

	fragment@0 {
		target = <0xffffffff>;

		__overlay__ {
			cs-gpios = <0xffffffff 0x2b 0x01 0xffffffff 0x2c 0x01 0xffffffff 0x2d 0x01>;
			status = "okay";
		};
	};

	fragment@1 {
		target = <0xffffffff>;

		__overlay__ {
			brcm,pins = <0x2d 0x2c 0x2b>;
			brcm,function = <0x01>;
			status = "okay";
		};
	};

	fragment@2 {
		target = <0xffffffff>;

		__overlay__ {
			brcm,pins = <0x28 0x29 0x2a>;
			brcm,function = <0x03>;
			status = "okay";
		};
	};

	__fixups__ {
		spi0 = "/fragment@0:target:0";
		gpio = "/fragment@0/__overlay__:cs-gpios:0\0/fragment@0/__overlay__:cs-gpios:12\0/fragment@0/__overlay__:cs-gpios:24";
		spi0_cs_pins = "/fragment@1:target:0";
		spi0_pins = "/fragment@2:target:0";
	};
};
