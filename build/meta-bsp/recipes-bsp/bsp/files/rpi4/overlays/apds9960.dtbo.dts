/dts-v1/;

/ {
	compatible = "brcm,bcm2835";

	fragment@0 {
		target = <0xffffffff>;

		__overlay__ {
			status = "okay";
		};
	};

	fragment@1 {
		target = <0xffffffff>;

		__overlay__ {

			apds9960_pins@39 {
				brcm,pins = <0x04>;
				brcm,function = <0x00>;
				phandle = <0x01>;
			};
		};
	};

	fragment@2 {
		target = <0xffffffff>;

		__overlay__ {
			#address-cells = <0x01>;
			#size-cells = <0x00>;

			apds@39 {
				compatible = "avago,apds9960";
				reg = <0x39>;
				status = "okay";
				phandle = <0x03>;
			};
		};
	};

	fragment@3 {
		target = <0xffffffff>;

		__overlay__ {

			apds@39 {
				#interrupt-cells = <0x02>;
				interrupt-parent = <0xffffffff>;
				interrupts = <0x04 0x01>;
				phandle = <0x02>;
			};
		};
	};

	__overrides__ {
		gpiopin = [00 00 00 01 62 72 63 6d 2c 70 69 6e 73 3a 30 00 00 00 00 02 69 6e 74 65 72 72 75 70 74 73 3a 30 00];
		noints = [00 00 00 00 21 31 21 33 00];
	};

	__symbols__ {
		apds9960_pins = "/fragment@1/__overlay__/apds9960_pins@39";
		apds9960 = "/fragment@2/__overlay__/apds@39";
		apds9960_irq = "/fragment@3/__overlay__/apds@39";
	};

	__fixups__ {
		i2c1 = "/fragment@0:target:0\0/fragment@2:target:0\0/fragment@3:target:0";
		gpio = "/fragment@1:target:0\0/fragment@3/__overlay__/apds@39:interrupt-parent:0";
	};

	__local_fixups__ {

		__overrides__ {
			gpiopin = <0x00 0x10>;
		};
	};
};
