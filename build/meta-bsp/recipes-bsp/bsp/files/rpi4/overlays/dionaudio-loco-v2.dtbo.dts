/dts-v1/;

/ {
	compatible = "brcm,bcm2835";

	fragment@0 {
		target = <0xffffffff>;

		__overlay__ {
			compatible = "dionaudio,dionaudio-loco-v2";
			i2s-controller = <0xffffffff>;
			status = "okay";
			phandle = <0x01>;
		};
	};

	fragment@1 {
		target = <0xffffffff>;

		__overlay__ {
			status = "okay";
		};
	};

	fragment@2 {
		target = <0xffffffff>;

		__overlay__ {
			#address-cells = <0x01>;
			#size-cells = <0x00>;
			status = "okay";

			pcm5122@4c {
				#sound-dai-cells = <0x00>;
				compatible = "ti,pcm5122";
				reg = <0x4d>;
				status = "okay";
			};
		};
	};

	__overrides__ {
		24db_digital_gain = [00 00 00 01 64 69 6f 6e 61 75 64 69 6f 2c 32 34 64 62 5f 64 69 67 69 74 61 6c 5f 67 61 69 6e 3f 00];
	};

	__symbols__ {
		frag0 = "/fragment@0/__overlay__";
	};

	__fixups__ {
		sound = "/fragment@0:target:0";
		i2s = "/fragment@0/__overlay__:i2s-controller:0\0/fragment@1:target:0";
		i2c1 = "/fragment@2:target:0";
	};

	__local_fixups__ {

		__overrides__ {
			24db_digital_gain = <0x00>;
		};
	};
};
