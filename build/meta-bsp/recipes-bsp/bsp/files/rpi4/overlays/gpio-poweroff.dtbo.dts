/dts-v1/;

/ {
	compatible = "brcm,bcm2835";

	fragment@0 {
		target-path = "/";

		__overlay__ {

			power_ctrl {
				compatible = "gpio-poweroff";
				gpios = <0xffffffff 0x1a 0x00>;
				force;
				phandle = <0x01>;
			};
		};
	};

	fragment@1 {
		target = <0xffffffff>;

		__overlay__ {

			power_ctrl_pins {
				brcm,pins = <0x1a>;
				brcm,function = <0x01>;
				phandle = <0x02>;
			};
		};
	};

	__overrides__ {
		gpiopin = <0x01 0x6770696f 0x733a3400 0x02 0x6272636d 0x2c70696e 0x733a3000>;
		active_low = <0x01 0x6770696f 0x733a3800>;
		input = [00 00 00 01 69 6e 70 75 74 3f 00];
		export = <0x01 0x6578706f 0x72743f00>;
		timeout_ms = [00 00 00 01 74 69 6d 65 6f 75 74 2d 6d 73 3a 30 00];
	};

	__symbols__ {
		power_ctrl = "/fragment@0/__overlay__/power_ctrl";
		power_ctrl_pins = "/fragment@1/__overlay__/power_ctrl_pins";
	};

	__fixups__ {
		gpio = "/fragment@0/__overlay__/power_ctrl:gpios:0\0/fragment@1:target:0";
	};

	__local_fixups__ {

		__overrides__ {
			gpiopin = <0x00 0x0c>;
			active_low = <0x00>;
			input = <0x00>;
			export = <0x00>;
			timeout_ms = <0x00>;
		};
	};
};
