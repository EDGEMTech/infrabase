/dts-v1/;

/ {
	compatible = "brcm,bcm2835";

	fragment@0 {
		target = <0xffffffff>;

		__overlay__ {
			status = "okay";
		};
	};

	fragment@1 {
		target = <0xffffffff>;

		__overlay__ {
			status = "disabled";
		};
	};

	fragment@2 {
		target = <0xffffffff>;

		__overlay__ {
			status = "disabled";
		};
	};

	fragment@3 {
		target = <0xffffffff>;

		__overlay__ {

			hy28b_pins {
				brcm,pins = <0x11 0x19 0x12>;
				brcm,function = <0x00 0x01 0x01>;
				phandle = <0x01>;
			};
		};
	};

	fragment@4 {
		target = <0xffffffff>;

		__overlay__ {
			#address-cells = <0x01>;
			#size-cells = <0x00>;

			hy28b@0 {
				compatible = "ilitek,ili9325";
				reg = <0x00>;
				pinctrl-names = "default";
				pinctrl-0 = <0x01>;
				spi-max-frequency = <0x2dc6c00>;
				spi-cpol;
				spi-cpha;
				rotate = <0x10e>;
				bgr;
				fps = <0x32>;
				buswidth = <0x08>;
				startbyte = <0x70>;
				reset-gpios = <0xffffffff 0x19 0x01>;
				led-gpios = <0xffffffff 0x12 0x01>;
				init = <0x10000e5 0x78f0 0x1000001 0x100 0x1000002 0x700 0x1000003 0x1030 0x1000004 0x00 0x1000008 0x207 0x1000009 0x00 0x100000a 0x00 0x100000c 0x00 0x100000d 0x00 0x100000f 0x00 0x1000010 0x00 0x1000011 0x07 0x1000012 0x00 0x1000013 0x00 0x1000007 0x01 0x2000032 0x2000032 0x2000032 0x2000032 0x1000010 0x1090 0x1000011 0x227 0x2000032 0x1000012 0x1f 0x2000032 0x1000013 0x1500 0x1000029 0x27 0x100002b 0x0d 0x2000032 0x1000020 0x00 0x1000021 0x00 0x2000032 0x1000030 0x00 0x1000031 0x707 0x1000032 0x307 0x1000035 0x200 0x1000036 0x08 0x1000037 0x04 0x1000038 0x00 0x1000039 0x707 0x100003c 0x02 0x100003d 0x1d04 0x1000050 0x00 0x1000051 0xef 0x1000052 0x00 0x1000053 0x13f 0x1000060 0xa700 0x1000061 0x01 0x100006a 0x00 0x1000080 0x00 0x1000081 0x00 0x1000082 0x00 0x1000083 0x00 0x1000084 0x00 0x1000085 0x00 0x1000090 0x10 0x1000092 0x600 0x1000007 0x133>;
				debug = <0x00>;
				phandle = <0x02>;
			};

			hy28b-ts@1 {
				compatible = "ti,ads7846";
				reg = <0x01>;
				spi-max-frequency = <0x1e8480>;
				interrupts = <0x11 0x02>;
				interrupt-parent = <0xffffffff>;
				pendown-gpio = <0xffffffff 0x11 0x00>;
				ti,x-plate-ohms = [00 64];
				ti,pressure-max = [00 ff];
				phandle = <0x03>;
			};
		};
	};

	__overrides__ {
		speed = <0x02 0x7370692d 0x6d61782d 0x66726571 0x75656e63 0x793a3000>;
		rotate = [00 00 00 02 72 6f 74 61 74 65 3a 30 00];
		fps = [00 00 00 02 66 70 73 3a 30 00];
		debug = <0x02 0x64656275 0x673a3000>;
		xohms = [00 00 00 03 74 69 2c 78 2d 70 6c 61 74 65 2d 6f 68 6d 73 3b 30 00];
		resetgpio = [00 00 00 02 72 65 73 65 74 2d 67 70 69 6f 73 3a 34 00 00 00 00 01 62 72 63 6d 2c 70 69 6e 73 3a 34 00];
		ledgpio = <0x02 0x6c65642d 0x6770696f 0x733a3400 0x01 0x6272636d 0x2c70696e 0x733a3800>;
	};

	__symbols__ {
		hy28b_pins = "/fragment@3/__overlay__/hy28b_pins";
		hy28b = "/fragment@4/__overlay__/hy28b@0";
		hy28b_ts = "/fragment@4/__overlay__/hy28b-ts@1";
	};

	__fixups__ {
		spi0 = "/fragment@0:target:0\0/fragment@4:target:0";
		spidev0 = "/fragment@1:target:0";
		spidev1 = "/fragment@2:target:0";
		gpio = "/fragment@3:target:0\0/fragment@4/__overlay__/hy28b@0:reset-gpios:0\0/fragment@4/__overlay__/hy28b@0:led-gpios:0\0/fragment@4/__overlay__/hy28b-ts@1:interrupt-parent:0\0/fragment@4/__overlay__/hy28b-ts@1:pendown-gpio:0";
	};

	__local_fixups__ {

		fragment@4 {

			__overlay__ {

				hy28b@0 {
					pinctrl-0 = <0x00>;
				};
			};
		};

		__overrides__ {
			speed = <0x00>;
			rotate = <0x00>;
			fps = <0x00>;
			debug = <0x00>;
			xohms = <0x00>;
			resetgpio = <0x00 0x12>;
			ledgpio = <0x00 0x10>;
		};
	};
};
