/dts-v1/;

/ {
	compatible = "brcm,bcm2835";

	fragment@0 {
		target = <0xffffffff>;

		__overlay__ {
			status = "okay";
		};
	};

	fragment@1 {
		target = <0xffffffff>;

		__overlay__ {
			#address-cells = <0x01>;
			#size-cells = <0x00>;
			status = "okay";

			pcm5142@4c {
				#sound-dai-cells = <0x00>;
				compatible = "ti,pcm5142";
				reg = <0x4c>;
				status = "okay";
			};
		};
	};

	fragment@2 {
		target = <0xffffffff>;

		__overlay__ {
			compatible = "allo,piano-dac";
			i2s-controller = <0xffffffff>;
			status = "okay";
			phandle = <0x01>;
		};
	};

	__overrides__ {
		24db_digital_gain = <0x01 0x616c6c6f 0x2c323464 0x625f6469 0x67697461 0x6c5f6761 0x696e3f00>;
	};

	__symbols__ {
		piano_dac = "/fragment@2/__overlay__";
	};

	__fixups__ {
		i2s = "/fragment@0:target:0\0/fragment@2/__overlay__:i2s-controller:0";
		i2c1 = "/fragment@1:target:0";
		sound = "/fragment@2:target:0";
	};

	__local_fixups__ {

		__overrides__ {
			24db_digital_gain = <0x00>;
		};
	};
};
