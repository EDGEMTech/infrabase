/dts-v1/;

/ {
	compatible = "brcm,bcm2835";

	fragment@0 {
		target = <0xffffffff>;

		__overlay__ {

			spi1_pins {
				brcm,pins = <0x13 0x14 0x15>;
				brcm,function = <0x03>;
				phandle = <0x01>;
			};

			spi1_cs_pins {
				brcm,pins = <0x12>;
				brcm,function = <0x01>;
				phandle = <0x02>;
			};
		};
	};

	fragment@1 {
		target = <0xffffffff>;

		__overlay__ {
			#address-cells = <0x01>;
			#size-cells = <0x00>;
			pinctrl-names = "default";
			pinctrl-0 = <0x01 0x02>;
			cs-gpios = <0xffffffff 0x12 0x01>;
			status = "okay";

			sc16is752@0 {
				compatible = "nxp,sc16is752";
				reg = <0x00>;
				clocks = <0x03>;
				interrupt-parent = <0xffffffff>;
				interrupts = <0x18 0x02>;
				gpio-controller;
				#gpio-cells = <0x02>;
				spi-max-frequency = "\0=\t";
				phandle = <0x04>;
			};
		};
	};

	fragment@2 {
		target = <0xffffffff>;

		__overlay__ {
			status = "okay";
		};
	};

	fragment@3 {
		target-path = "/";

		__overlay__ {

			sc16is752_spi1_0_clk {
				compatible = "fixed-clock";
				#clock-cells = <0x00>;
				clock-frequency = <0xe10000>;
				phandle = <0x03>;
			};
		};
	};

	__overrides__ {
		int_pin = [00 00 00 04 69 6e 74 65 72 72 75 70 74 73 3a 30 00];
		xtal = [00 00 00 03 63 6c 6f 63 6b 2d 66 72 65 71 75 65 6e 63 79 3a 30 00];
	};

	__symbols__ {
		spi1_pins = "/fragment@0/__overlay__/spi1_pins";
		spi1_cs_pins = "/fragment@0/__overlay__/spi1_cs_pins";
		sc16is752 = "/fragment@1/__overlay__/sc16is752@0";
		sc16is752_clk = "/fragment@3/__overlay__/sc16is752_spi1_0_clk";
	};

	__fixups__ {
		gpio = "/fragment@0:target:0\0/fragment@1/__overlay__:cs-gpios:0\0/fragment@1/__overlay__/sc16is752@0:interrupt-parent:0";
		spi1 = "/fragment@1:target:0";
		aux = "/fragment@2:target:0";
	};

	__local_fixups__ {

		fragment@1 {

			__overlay__ {
				pinctrl-0 = <0x00 0x04>;

				sc16is752@0 {
					clocks = <0x00>;
				};
			};
		};

		__overrides__ {
			int_pin = <0x00>;
			xtal = <0x00>;
		};
	};
};
