/dts-v1/;

/ {
	compatible = "brcm,bcm2835";

	fragment@0 {
		target = <0xffffffff>;

		__overlay__ {
			status = "okay";
		};
	};

	fragment@1 {
		target = <0xffffffff>;

		__overlay__ {
			status = "disabled";
		};
	};

	fragment@2 {
		target = <0xffffffff>;

		__overlay__ {
			status = "okay";
		};
	};

	fragment@3 {
		target = <0xffffffff>;

		__overlay__ {
			status = "okay";
		};
	};

	fragment@4 {
		target = <0xffffffff>;

		__overlay__ {
			status = "okay";
		};
	};

	fragment@5 {
		target = <0xffffffff>;

		__overlay__ {
			status = "okay";
		};
	};

	fragment@6 {
		target = <0xffffffff>;

		__overlay__ {
			status = "okay";
		};
	};

	fragment@7 {
		target = <0xffffffff>;

		__overlay__ {
			status = "okay";
		};
	};

	fragment@8 {
		target = <0xffffffff>;

		__overlay__ {
			status = "okay";
		};
	};

	fragment@9 {
		target = <0xffffffff>;

		__overlay__ {
			claim-clocks = <0x22 0x23 0x0f 0x10>;
		};
	};

	fragment@10 {
		target = <0xffffffff>;

		__overlay__ {
			status = "okay";
		};
	};

	fragment@11 {
		target = <0xffffffff>;

		__overlay__ {
			status = "okay";
		};
	};

	fragment@12 {
		target = <0xffffffff>;

		__overlay__ {
			brcm,disable-hdmi;
		};
	};

	fragment@13 {
		target = <0xffffffff>;
		#address-cells = <0x01>;
		#size-cells = <0x01>;

		__overlay__ {
			compatible = "brcm,bcm2835-usb";
			dr_mode = "otg";
			g-np-tx-fifo-size = <0x20>;
			g-rx-fifo-size = <0x22e>;
			g-tx-fifo-size = <0x200 0x200 0x200 0x200 0x200 0x100 0x100>;
			status = "okay";
		};
	};

	__fixups__ {
		i2c2 = "/fragment@0:target:0";
		fb = "/fragment@1:target:0";
		pixelvalve0 = "/fragment@2:target:0";
		pixelvalve1 = "/fragment@3:target:0";
		pixelvalve2 = "/fragment@4:target:0";
		hvs = "/fragment@5:target:0";
		hdmi = "/fragment@6:target:0";
		v3d = "/fragment@7:target:0";
		vc4 = "/fragment@8:target:0";
		clocks = "/fragment@9:target:0";
		vec = "/fragment@10:target:0";
		txp = "/fragment@11:target:0";
		audio = "/fragment@12:target:0";
		usb = "/fragment@13:target:0";
	};
};
