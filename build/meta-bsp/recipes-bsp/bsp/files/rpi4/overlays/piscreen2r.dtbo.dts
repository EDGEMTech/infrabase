/dts-v1/;

/ {
	compatible = "brcm,bcm2835";

	fragment@0 {
		target = <0xffffffff>;

		__overlay__ {
			status = "okay";
		};
	};

	fragment@1 {
		target = <0xffffffff>;

		__overlay__ {
			status = "disabled";
		};
	};

	fragment@2 {
		target = <0xffffffff>;

		__overlay__ {
			status = "disabled";
		};
	};

	fragment@3 {
		target = <0xffffffff>;

		__overlay__ {

			piscreen2_pins {
				brcm,pins = <0x11 0x19 0x18 0x16>;
				brcm,function = <0x00 0x01 0x01 0x01>;
				phandle = <0x01>;
			};
		};
	};

	fragment@4 {
		target = <0xffffffff>;

		__overlay__ {
			#address-cells = <0x01>;
			#size-cells = <0x00>;

			piscreen2@0 {
				compatible = "ilitek,ili9486";
				reg = <0x00>;
				pinctrl-names = "default";
				pinctrl-0 = <0x01>;
				bgr;
				spi-max-frequency = <0x3d09000>;
				rotate = <0x5a>;
				fps = <0x1e>;
				buswidth = <0x08>;
				regwidth = <0x10>;
				txbuflen = <0x8000>;
				reset-gpios = <0xffffffff 0x19 0x01>;
				dc-gpios = <0xffffffff 0x18 0x00>;
				led-gpios = <0xffffffff 0x16 0x00>;
				debug = <0x00>;
				init = <0x10000b0 0x00 0x1000011 0x20000ff 0x100003a 0x55 0x1000036 0x28 0x10000c0 0x11 0x09 0x10000c1 0x41 0x10000c5 0x00 0x00 0x00 0x00 0x10000b6 0x00 0x02 0x10000f7 0xa9 0x51 0x2c 0x02 0x10000be 0x00 0x04 0x10000e9 0x00 0x1000011 0x1000029>;
				phandle = <0x02>;
			};

			piscreen2-ts@1 {
				compatible = "ti,ads7846";
				reg = <0x01>;
				spi-max-frequency = <0x1e8480>;
				interrupts = <0x11 0x02>;
				interrupt-parent = <0xffffffff>;
				pendown-gpio = <0xffffffff 0x11 0x00>;
				ti,swap-xy;
				ti,x-plate-ohms = [00 64];
				ti,pressure-max = [00 ff];
				phandle = <0x03>;
			};
		};
	};

	__overrides__ {
		speed = <0x02 0x7370692d 0x6d61782d 0x66726571 0x75656e63 0x793a3000>;
		rotate = [00 00 00 02 72 6f 74 61 74 65 3a 30 00];
		fps = [00 00 00 02 66 70 73 3a 30 00];
		debug = <0x02 0x64656275 0x673a3000>;
		xohms = [00 00 00 03 74 69 2c 78 2d 70 6c 61 74 65 2d 6f 68 6d 73 3b 30 00];
	};

	__symbols__ {
		piscreen2_pins = "/fragment@3/__overlay__/piscreen2_pins";
		piscreen2 = "/fragment@4/__overlay__/piscreen2@0";
		piscreen2_ts = "/fragment@4/__overlay__/piscreen2-ts@1";
	};

	__fixups__ {
		spi0 = "/fragment@0:target:0\0/fragment@4:target:0";
		spidev0 = "/fragment@1:target:0";
		spidev1 = "/fragment@2:target:0";
		gpio = "/fragment@3:target:0\0/fragment@4/__overlay__/piscreen2@0:reset-gpios:0\0/fragment@4/__overlay__/piscreen2@0:dc-gpios:0\0/fragment@4/__overlay__/piscreen2@0:led-gpios:0\0/fragment@4/__overlay__/piscreen2-ts@1:interrupt-parent:0\0/fragment@4/__overlay__/piscreen2-ts@1:pendown-gpio:0";
	};

	__local_fixups__ {

		fragment@4 {

			__overlay__ {

				piscreen2@0 {
					pinctrl-0 = <0x00>;
				};
			};
		};

		__overrides__ {
			speed = <0x00>;
			rotate = <0x00>;
			fps = <0x00>;
			debug = <0x00>;
			xohms = <0x00>;
		};
	};
};
