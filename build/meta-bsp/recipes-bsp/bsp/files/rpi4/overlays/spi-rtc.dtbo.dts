/dts-v1/;

/ {
	compatible = "brcm,bcm2835";

	fragment@0 {
		target = <0x01>;

		__dormant__ {
			compatible = "maxim,ds3232";
		};
	};

	fragment@1 {
		target = <0x01>;

		__dormant__ {
			compatible = "maxim,ds3234";
		};
	};

	fragment@2 {
		target = <0x01>;

		__dormant__ {
			compatible = "nxp,rtc-pcf2123";
		};
	};

	fragment@100 {
		target = <0xffffffff>;
		phandle = <0x02>;

		__overlay__ {
			status = "disabled";
		};
	};

	fragment@101 {
		target = <0xffffffff>;
		phandle = <0x03>;

		__overlay__ {
			#address-cells = <0x01>;
			#size-cells = <0x00>;
			status = "okay";

			rtc@0 {
				reg = <0x00>;
				spi-max-frequency = <0x4c4b40>;
				phandle = <0x01>;
			};
		};
	};

	__overrides__ {
		spi0_0 = <0x02 0x74617267 0x65743a30 0x3d00ffff 0xffff0000 0x37461 0x72676574 0x3a303d00 0xffffffff 0x01 0x7265673a 0x303d3000>;
		spi0_1 = <0x02 0x74617267 0x65743a30 0x3d00ffff 0xffff0000 0x37461 0x72676574 0x3a303d00 0xffffffff 0x01 0x7265673a 0x303d3100>;
		spi1_0 = [00 00 00 00 2d 31 30 30 00 00 00 00 03 74 61 72 67 65 74 3a 30 3d 00 ff ff ff ff 00 00 00 01 72 65 67 3a 30 3d 30 00];
		spi1_1 = [00 00 00 00 2d 31 30 30 00 00 00 00 03 74 61 72 67 65 74 3a 30 3d 00 ff ff ff ff 00 00 00 01 72 65 67 3a 30 3d 31 00];
		spi2_0 = [00 00 00 00 2d 31 30 30 00 00 00 00 03 74 61 72 67 65 74 3a 30 3d 00 ff ff ff ff 00 00 00 01 72 65 67 3a 30 3d 30 00];
		spi2_1 = [00 00 00 00 2d 31 30 30 00 00 00 00 03 74 61 72 67 65 74 3a 30 3d 00 ff ff ff ff 00 00 00 01 72 65 67 3a 30 3d 31 00];
		cs_high = [00 00 00 01 73 70 69 2d 63 73 2d 68 69 67 68 3f 00];
		ds3232 = [00 00 00 00 2b 30 00];
		ds3234 = [00 00 00 00 2b 31 00];
		pcf2123 = [00 00 00 00 2b 32 00];
	};

	__symbols__ {
		spidev = "/fragment@100";
		frag101 = "/fragment@101";
		rtc = "/fragment@101/__overlay__/rtc@0";
	};

	__fixups__ {
		spidev0 = "/fragment@100:target:0\0/__overrides__:spi0_0:14";
		spi0 = "/fragment@101:target:0\0/__overrides__:spi0_0:32\0/__overrides__:spi0_1:32";
		spidev1 = "/__overrides__:spi0_1:14";
		spi1 = "/__overrides__:spi1_0:23\0/__overrides__:spi1_1:23";
		spi2 = "/__overrides__:spi2_0:23\0/__overrides__:spi2_1:23";
	};

	__local_fixups__ {

		fragment@0 {
			target = <0x00>;
		};

		fragment@1 {
			target = <0x00>;
		};

		fragment@2 {
			target = <0x00>;
		};

		__overrides__ {
			spi0_0 = <0x00 0x12 0x24>;
			spi0_1 = <0x00 0x12 0x24>;
			spi1_0 = <0x09 0x1b>;
			spi1_1 = <0x09 0x1b>;
			spi2_0 = <0x09 0x1b>;
			spi2_1 = <0x09 0x1b>;
			cs_high = <0x00>;
		};
	};
};
