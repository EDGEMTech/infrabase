/dts-v1/;

/ {
	compatible = "brcm,bcm2835";

	fragment@0 {
		target = <0xffffffff>;

		__overlay__ {
			pinctrl-names = "default";
			pinctrl-0 = <0xffffffff>;
		};
	};

	fragment@1 {
		target = <0xffffffff>;

		__overlay__ {
			pinctrl-names = "default";
			pinctrl-0 = <0xffffffff>;
		};
	};

	__fixups__ {
		fb = "/fragment@0:target:0";
		dpi_18bit_cpadhi_gpio0 = "/fragment@0/__overlay__:pinctrl-0:0\0/fragment@1/__overlay__:pinctrl-0:0";
		vc4 = "/fragment@1:target:0";
	};
};
