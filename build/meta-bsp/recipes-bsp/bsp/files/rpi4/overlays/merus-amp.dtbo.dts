/dts-v1/;

/ {
	compatible = "brcm,bcm2835";

	fragment@0 {
		target = <0xffffffff>;

		__overlay__ {
			status = "okay";
		};
	};

	fragment@1 {
		target = <0xffffffff>;

		__overlay__ {

			merus_amp_pins {
				brcm,pins = <0x17>;
				brcm,function = <0x00>;
				brcm,pull = <0x02>;
				phandle = <0x01>;
			};
		};
	};

	fragment@2 {
		target = <0xffffffff>;

		__overlay__ {
			#address-cells = <0x01>;
			#size-cells = <0x00>;
			status = "okay";

			ma120x0p@20 {
				#sound-dai-cells = <0x00>;
				compatible = "ma,ma120x0p";
				reg = <0x20>;
				status = "okay";
				pinctrl-names = "default";
				pinctrl-0 = <0x01>;
				enable_gp-gpios = <0xffffffff 0x0e 0x00>;
				mute_gp-gpios = <0xffffffff 0x0f 0x00>;
				booster_gp-gpios = <0xffffffff 0x11 0x00>;
				error_gp-gpios = <0xffffffff 0x17 0x00>;
				phandle = <0x02>;
			};
		};
	};

	fragment@3 {
		target = <0xffffffff>;

		__overlay__ {
			compatible = "merus,merus-amp";
			i2s-controller = <0xffffffff>;
			status = "okay";
		};
	};

	__symbols__ {
		merus_amp_pins = "/fragment@1/__overlay__/merus_amp_pins";
		merus_amp = "/fragment@2/__overlay__/ma120x0p@20";
	};

	__fixups__ {
		i2s = "/fragment@0:target:0\0/fragment@3/__overlay__:i2s-controller:0";
		gpio = "/fragment@1:target:0\0/fragment@2/__overlay__/ma120x0p@20:enable_gp-gpios:0\0/fragment@2/__overlay__/ma120x0p@20:mute_gp-gpios:0\0/fragment@2/__overlay__/ma120x0p@20:booster_gp-gpios:0\0/fragment@2/__overlay__/ma120x0p@20:error_gp-gpios:0";
		i2c1 = "/fragment@2:target:0";
		sound = "/fragment@3:target:0";
	};

	__local_fixups__ {

		fragment@2 {

			__overlay__ {

				ma120x0p@20 {
					pinctrl-0 = <0x00>;
				};
			};
		};
	};
};
