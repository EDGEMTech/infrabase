/dts-v1/;

/ {
	compatible = "brcm,bcm2711";

	fragment@0 {
		target = <0xffffffff>;

		__overlay__ {
			status = "okay";
			pinctrl-names = "default";
			pinctrl-0 = <0xffffffff>;
			clock-frequency = <0x186a0>;
			phandle = <0x01>;
		};
	};

	fragment@1 {
		target = <0xffffffff>;

		__dormant__ {
			brcm,pins = <0x00 0x01>;
		};
	};

	fragment@2 {
		target = <0xffffffff>;

		__overlay__ {
			brcm,pins = <0x16 0x17>;
		};
	};

	__overrides__ {
		pins_0_1 = [00 00 00 00 3d 31 21 32 00];
		pins_22_23 = [00 00 00 00 21 31 3d 32 00];
		baudrate = [00 00 00 01 63 6c 6f 63 6b 2d 66 72 65 71 75 65 6e 63 79 3a 30 00];
	};

	__symbols__ {
		frag0 = "/fragment@0/__overlay__";
	};

	__fixups__ {
		i2c6 = "/fragment@0:target:0";
		i2c6_pins = "/fragment@0/__overlay__:pinctrl-0:0\0/fragment@1:target:0\0/fragment@2:target:0";
	};

	__local_fixups__ {

		__overrides__ {
			baudrate = <0x00>;
		};
	};
};
