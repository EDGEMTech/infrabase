/dts-v1/;

/ {
	compatible = "brcm,bcm2835";

	fragment@0 {
		target = <0xffffffff>;

		__overlay__ {
			compatible = "audiophonics,i-sabre-q2m";
			i2s-controller = <0xffffffff>;
			status = "okay";
			phandle = <0x01>;
		};
	};

	fragment@1 {
		target = <0xffffffff>;

		__overlay__ {
			status = "okay";
		};
	};

	fragment@2 {
		target = <0xffffffff>;

		__overlay__ {
			#address-cells = <0x01>;
			#size-cells = <0x00>;
			status = "okay";

			i-sabre-codec@48 {
				#sound-dai-cells = <0x00>;
				compatible = "audiophonics,i-sabre-codec";
				reg = <0x48>;
				status = "okay";
			};
		};
	};

	__symbols__ {
		frag0 = "/fragment@0/__overlay__";
	};

	__fixups__ {
		sound = "/fragment@0:target:0";
		i2s = "/fragment@0/__overlay__:i2s-controller:0\0/fragment@1:target:0";
		i2c1 = "/fragment@2:target:0";
	};
};
