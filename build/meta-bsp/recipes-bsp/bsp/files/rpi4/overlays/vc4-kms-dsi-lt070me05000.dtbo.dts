/dts-v1/;

/ {
	compatible = "brcm,bcm2835";

	fragment@0 {
		target = <0xffffffff>;

		__overlay__ {
			status = "okay";
			#address-cells = <0x01>;
			#size-cells = <0x00>;

			port {

				endpoint {
					remote-endpoint = <0x01>;
					phandle = <0x02>;
				};
			};

			lt070me05000@0 {
				compatible = "jdi,lt070me05000";
				status = "okay";
				reg = <0x00>;
				reset-gpios = <0xffffffff 0x11 0x01>;
				enable-gpios = <0xffffffff 0x04 0x00>;
				dcdc-en-gpios = <0xffffffff 0x05 0x00>;
				phandle = <0x04>;

				port {

					endpoint {
						remote-endpoint = <0x02>;
						phandle = <0x01>;
					};
				};
			};
		};
	};

	fragment@1 {
		target = <0xffffffff>;

		__overlay__ {

			lt070me05000_pins {
				brcm,pins = <0x04 0x05 0x11>;
				brcm,function = <0x01 0x01 0x01>;
				brcm,pull = <0x00 0x00 0x00>;
				phandle = <0x03>;
			};
		};
	};

	__overrides__ {
		reset = [00 00 00 03 62 72 63 6d 2c 70 69 6e 73 3a 38 00 00 00 00 04 72 65 73 65 74 2d 67 70 69 6f 73 3a 34 00];
		enable = [00 00 00 03 62 72 63 6d 2c 70 69 6e 73 3a 30 00 00 00 00 04 65 6e 61 62 6c 65 2d 67 70 69 6f 73 3a 34 00];
		dcdc-en = <0x03 0x6272636d 0x2c70696e 0x733a3400 0x04 0x64636463 0x2d656e2d 0x6770696f 0x733a3400>;
	};

	__symbols__ {
		dsi_out_port = "/fragment@0/__overlay__/port/endpoint";
		lt070me05000 = "/fragment@0/__overlay__/lt070me05000@0";
		panel_dsi_port = "/fragment@0/__overlay__/lt070me05000@0/port/endpoint";
		lt070me05000_pins = "/fragment@1/__overlay__/lt070me05000_pins";
	};

	__fixups__ {
		dsi1 = "/fragment@0:target:0";
		gpio = "/fragment@0/__overlay__/lt070me05000@0:reset-gpios:0\0/fragment@0/__overlay__/lt070me05000@0:enable-gpios:0\0/fragment@0/__overlay__/lt070me05000@0:dcdc-en-gpios:0\0/fragment@1:target:0";
	};

	__local_fixups__ {

		fragment@0 {

			__overlay__ {

				port {

					endpoint {
						remote-endpoint = <0x00>;
					};
				};

				lt070me05000@0 {

					port {

						endpoint {
							remote-endpoint = <0x00>;
						};
					};
				};
			};
		};

		__overrides__ {
			reset = <0x00 0x10>;
			enable = <0x00 0x10>;
			dcdc-en = <0x00 0x10>;
		};
	};
};
