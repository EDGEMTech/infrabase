/dts-v1/;

/ {
	compatible = "brcm,bcm2835";

	fragment@0 {
		target = <0xffffffff>;

		__overlay__ {
			status = "okay";
		};
	};

	fragment@1 {
		target = <0xffffffff>;

		__overlay__ {
			status = "disabled";
		};
	};

	fragment@2 {
		target = <0xffffffff>;

		__overlay__ {
			status = "disabled";
		};
	};

	fragment@3 {
		target = <0xffffffff>;

		__overlay__ {

			hy28a_pins {
				brcm,pins = <0x11 0x19 0x12>;
				brcm,function = <0x00 0x01 0x01>;
				phandle = <0x01>;
			};
		};
	};

	fragment@4 {
		target = <0xffffffff>;

		__overlay__ {
			#address-cells = <0x01>;
			#size-cells = <0x00>;

			hy28a@0 {
				compatible = "ilitek,ili9320";
				reg = <0x00>;
				pinctrl-names = "default";
				pinctrl-0 = <0x01>;
				spi-max-frequency = <0x1e84800>;
				spi-cpol;
				spi-cpha;
				rotate = <0x10e>;
				bgr;
				fps = <0x32>;
				buswidth = <0x08>;
				startbyte = <0x70>;
				reset-gpios = <0xffffffff 0x19 0x01>;
				led-gpios = <0xffffffff 0x12 0x01>;
				debug = <0x00>;
				phandle = <0x02>;
			};

			hy28a-ts@1 {
				compatible = "ti,ads7846";
				reg = <0x01>;
				spi-max-frequency = <0x1e8480>;
				interrupts = <0x11 0x02>;
				interrupt-parent = <0xffffffff>;
				pendown-gpio = <0xffffffff 0x11 0x00>;
				ti,x-plate-ohms = [00 64];
				ti,pressure-max = [00 ff];
				phandle = <0x03>;
			};
		};
	};

	__overrides__ {
		speed = <0x02 0x7370692d 0x6d61782d 0x66726571 0x75656e63 0x793a3000>;
		rotate = [00 00 00 02 72 6f 74 61 74 65 3a 30 00];
		fps = [00 00 00 02 66 70 73 3a 30 00];
		debug = <0x02 0x64656275 0x673a3000>;
		xohms = [00 00 00 03 74 69 2c 78 2d 70 6c 61 74 65 2d 6f 68 6d 73 3b 30 00];
		resetgpio = [00 00 00 02 72 65 73 65 74 2d 67 70 69 6f 73 3a 34 00 00 00 00 01 62 72 63 6d 2c 70 69 6e 73 3a 34 00];
		ledgpio = <0x02 0x6c65642d 0x6770696f 0x733a3400 0x01 0x6272636d 0x2c70696e 0x733a3800>;
	};

	__symbols__ {
		hy28a_pins = "/fragment@3/__overlay__/hy28a_pins";
		hy28a = "/fragment@4/__overlay__/hy28a@0";
		hy28a_ts = "/fragment@4/__overlay__/hy28a-ts@1";
	};

	__fixups__ {
		spi0 = "/fragment@0:target:0\0/fragment@4:target:0";
		spidev0 = "/fragment@1:target:0";
		spidev1 = "/fragment@2:target:0";
		gpio = "/fragment@3:target:0\0/fragment@4/__overlay__/hy28a@0:reset-gpios:0\0/fragment@4/__overlay__/hy28a@0:led-gpios:0\0/fragment@4/__overlay__/hy28a-ts@1:interrupt-parent:0\0/fragment@4/__overlay__/hy28a-ts@1:pendown-gpio:0";
	};

	__local_fixups__ {

		fragment@4 {

			__overlay__ {

				hy28a@0 {
					pinctrl-0 = <0x00>;
				};
			};
		};

		__overrides__ {
			speed = <0x00>;
			rotate = <0x00>;
			fps = <0x00>;
			debug = <0x00>;
			xohms = <0x00>;
			resetgpio = <0x00 0x12>;
			ledgpio = <0x00 0x10>;
		};
	};
};
