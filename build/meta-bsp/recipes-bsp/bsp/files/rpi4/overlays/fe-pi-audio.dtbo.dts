/dts-v1/;

/ {
	compatible = "brcm,bcm2835";

	fragment@0 {
		target-path = "/";

		__overlay__ {

			sgtl5000_mclk {
				compatible = "fixed-clock";
				#clock-cells = <0x00>;
				clock-frequency = <0xbb8000>;
				clock-output-names = "sgtl5000-mclk";
				phandle = <0x01>;
			};
		};
	};

	fragment@1 {
		target = <0xffffffff>;

		__overlay__ {

			reg_1v8@0 {
				compatible = "regulator-fixed";
				regulator-name = "1V8";
				regulator-min-microvolt = <0x1b7740>;
				regulator-max-microvolt = <0x1b7740>;
				regulator-always-on;
				phandle = <0x02>;
			};
		};
	};

	fragment@2 {
		target = <0xffffffff>;

		__overlay__ {
			#address-cells = <0x01>;
			#size-cells = <0x00>;
			status = "okay";

			sgtl5000@0a {
				#sound-dai-cells = <0x00>;
				compatible = "fsl,sgtl5000";
				reg = <0x0a>;
				clocks = <0x01>;
				micbias-resistor-k-ohms = <0x02>;
				micbias-voltage-m-volts = <0xbb8>;
				VDDA-supply = <0xffffffff>;
				VDDIO-supply = <0xffffffff>;
				VDDD-supply = <0x02>;
				status = "okay";
			};
		};
	};

	fragment@3 {
		target = <0xffffffff>;

		__overlay__ {
			status = "okay";
		};
	};

	fragment@4 {
		target = <0xffffffff>;

		__overlay__ {
			compatible = "fe-pi,fe-pi-audio";
			i2s-controller = <0xffffffff>;
			status = "okay";
		};
	};

	__symbols__ {
		sgtl5000_mclk = "/fragment@0/__overlay__/sgtl5000_mclk";
		reg_1v8 = "/fragment@1/__overlay__/reg_1v8@0";
	};

	__fixups__ {
		soc = "/fragment@1:target:0";
		i2c1 = "/fragment@2:target:0";
		vdd_3v3_reg = "/fragment@2/__overlay__/sgtl5000@0a:VDDA-supply:0\0/fragment@2/__overlay__/sgtl5000@0a:VDDIO-supply:0";
		i2s = "/fragment@3:target:0\0/fragment@4/__overlay__:i2s-controller:0";
		sound = "/fragment@4:target:0";
	};

	__local_fixups__ {

		fragment@2 {

			__overlay__ {

				sgtl5000@0a {
					clocks = <0x00>;
					VDDD-supply = <0x00>;
				};
			};
		};
	};
};
