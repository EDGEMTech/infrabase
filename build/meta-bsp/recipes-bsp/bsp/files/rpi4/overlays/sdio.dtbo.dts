/dts-v1/;

/ {
	compatible = "brcm,bcm2835";

	fragment@0 {
		target = <0xffffffff>;

		__overlay__ {
			status = "disabled";
		};
	};

	fragment@1 {
		target = <0xffffffff>;

		__overlay__ {
			pinctrl-0 = <0x01>;
			pinctrl-names = "default";
			non-removable;
			bus-width = <0x04>;
			status = "okay";
			phandle = <0x02>;
		};
	};

	fragment@2 {
		target = <0xffffffff>;

		__overlay__ {

			sdio_ovl_pins {
				brcm,pins = <0x16 0x17 0x18 0x19 0x1a 0x1b>;
				brcm,function = <0x07>;
				brcm,pull = <0x00 0x02 0x02 0x02 0x02 0x02>;
				phandle = <0x01>;
			};
		};
	};

	fragment@3 {
		target = <0x01>;

		__dormant__ {
			brcm,pins = <0x16 0x17 0x18 0x19>;
			brcm,pull = <0x00 0x02 0x02 0x02>;
		};
	};

	fragment@4 {
		target = <0x01>;

		__dormant__ {
			brcm,pins = <0x22 0x23 0x24 0x25>;
			brcm,pull = <0x00 0x02 0x02 0x02>;
		};
	};

	fragment@5 {
		target = <0x01>;

		__dormant__ {
			brcm,pins = <0x22 0x23 0x24 0x25 0x26 0x27>;
			brcm,pull = <0x00 0x02 0x02 0x02 0x02 0x02>;
		};
	};

	fragment@6 {
		target-path = "/aliases";

		__overlay__ {
			mmc1 = "/soc/mmc@7e300000";
		};
	};

	__overrides__ {
		poll_once = [00 00 00 02 6e 6f 6e 2d 72 65 6d 6f 76 61 62 6c 65 3f 00];
		bus_width = <0x02 0x6275732d 0x77696474 0x683a3000>;
		sdio_overclock = <0x02 0x6272636d 0x2c6f7665 0x72636c6f 0x636b2d35 0x303a3000>;
		gpios_22_25 = [00 00 00 00 3d 33 00];
		gpios_34_37 = [00 00 00 00 3d 34 00];
		gpios_34_39 = [00 00 00 00 3d 35 00];
	};

	__symbols__ {
		sdio_ovl = "/fragment@1/__overlay__";
		sdio_ovl_pins = "/fragment@2/__overlay__/sdio_ovl_pins";
	};

	__fixups__ {
		mmcnr = "/fragment@0:target:0";
		mmc = "/fragment@1:target:0";
		gpio = "/fragment@2:target:0";
	};

	__local_fixups__ {

		fragment@1 {

			__overlay__ {
				pinctrl-0 = <0x00>;
			};
		};

		fragment@3 {
			target = <0x00>;
		};

		fragment@4 {
			target = <0x00>;
		};

		fragment@5 {
			target = <0x00>;
		};

		__overrides__ {
			poll_once = <0x00>;
			bus_width = <0x00>;
			sdio_overclock = <0x00>;
		};
	};
};
