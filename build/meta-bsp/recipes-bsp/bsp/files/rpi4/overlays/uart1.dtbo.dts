/dts-v1/;

/ {
	compatible = "brcm,bcm2835";

	fragment@0 {
		target = <0xffffffff>;

		__overlay__ {
			pinctrl-names = "default";
			pinctrl-0 = <0x01>;
			status = "okay";
		};
	};

	fragment@1 {
		target = <0xffffffff>;

		__overlay__ {

			uart1_pins {
				brcm,pins = <0x0e 0x0f>;
				brcm,function = <0x02>;
				brcm,pull = <0x00 0x02>;
				phandle = <0x01>;
			};
		};
	};

	fragment@2 {
		target-path = "/chosen";

		__overlay__ {
			bootargs = "8250.nr_uarts=1";
		};
	};

	__overrides__ {
		txd1_pin = <0x01 0x6272636d 0x2c70696e 0x733a3000>;
		rxd1_pin = <0x01 0x6272636d 0x2c70696e 0x733a3400>;
	};

	__symbols__ {
		uart1_pins = "/fragment@1/__overlay__/uart1_pins";
	};

	__fixups__ {
		uart1 = "/fragment@0:target:0";
		gpio = "/fragment@1:target:0";
	};

	__local_fixups__ {

		fragment@0 {

			__overlay__ {
				pinctrl-0 = <0x00>;
			};
		};

		__overrides__ {
			txd1_pin = <0x00>;
			rxd1_pin = <0x00>;
		};
	};
};
