/dts-v1/;

/ {
	compatible = "brcm,bcm2835";

	fragment@0 {
		target = <0xffffffff>;

		__overlay__ {
			status = "okay";
			pinctrl-names = "default";
			pinctrl-0 = <0xffffffff>;
		};
	};

	fragment@1 {
		target = <0xffffffff>;

		__overlay__ {
			brcm,pins = <0x02 0x03>;
			brcm,function = <0x04>;
			phandle = <0x01>;
		};
	};

	fragment@2 {
		target = <0xffffffff>;

		__dormant__ {
			brcm,pins = <0x2c 0x2d>;
			brcm,function = <0x06>;
			phandle = <0x02>;
		};
	};

	fragment@3 {
		target = <0xffffffff>;

		__dormant__ {
			compatible = "brcm,bcm2708-i2c";
		};
	};

	__overrides__ {
		pins_2_3 = [00 00 00 00 3d 31 21 32 00];
		pins_44_45 = [00 00 00 00 21 31 3d 32 00];
		combine = [00 00 00 00 21 33 00];
	};

	__symbols__ {
		pins1 = "/fragment@1/__overlay__";
		pins2 = "/fragment@2/__dormant__";
	};

	__fixups__ {
		i2c1 = "/fragment@0:target:0\0/fragment@3:target:0";
		i2c1_pins = "/fragment@0/__overlay__:pinctrl-0:0\0/fragment@1:target:0\0/fragment@2:target:0";
	};
};
