/dts-v1/;

/ {
	compatible = "brcm,bcm2835";

	fragment@0 {
		target = <0xffffffff>;

		__overlay__ {
			gpios = <0xffffffff 0x00 0x00>;
			phandle = <0x01>;
		};
	};

	__overrides__ {
		gpio = <0x01 0x6770696f 0x733a3400>;
		activelow = <0x01 0x6770696f 0x733a3800>;
	};

	__symbols__ {
		frag0 = "/fragment@0/__overlay__";
	};

	__fixups__ {
		act_led = "/fragment@0:target:0";
		gpio = "/fragment@0/__overlay__:gpios:0";
	};

	__local_fixups__ {

		__overrides__ {
			gpio = <0x00>;
			activelow = <0x00>;
		};
	};
};
