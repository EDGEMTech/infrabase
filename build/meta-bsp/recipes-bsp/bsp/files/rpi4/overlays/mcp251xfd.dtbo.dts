/dts-v1/;

/ {
	compatible = "brcm,bcm2835";

	fragment@0 {
		target = <0xffffffff>;

		__dormant__ {
			status = "disabled";
		};
	};

	fragment@1 {
		target = <0xffffffff>;

		__dormant__ {
			status = "disabled";
		};
	};

	fragment@2 {
		target-path = "spi1/spidev@0";

		__dormant__ {
			status = "disabled";
		};
	};

	fragment@3 {
		target-path = "spi1/spidev@1";

		__dormant__ {
			status = "disabled";
		};
	};

	fragment@4 {
		target-path = "spi1/spidev@2";

		__dormant__ {
			status = "disabled";
		};
	};

	fragment@5 {
		target-path = "spi2/spidev@0";

		__dormant__ {
			status = "disabled";
		};
	};

	fragment@6 {
		target-path = "spi2/spidev@1";

		__dormant__ {
			status = "disabled";
		};
	};

	fragment@7 {
		target-path = "spi2/spidev@2";

		__dormant__ {
			status = "disabled";
		};
	};

	fragment@8 {
		target = <0xffffffff>;

		__overlay__ {

			mcp251xfd_pins {
				brcm,pins = <0x19>;
				brcm,function = <0x00>;
				phandle = <0x01>;
			};
		};
	};

	fragment@9 {
		target-path = "/clocks";

		__overlay__ {

			mcp251xfd-osc {
				#clock-cells = <0x00>;
				compatible = "fixed-clock";
				clock-frequency = <0x2625a00>;
				phandle = <0x02>;
			};
		};
	};

	fragment@10 {
		target = <0xffffffff>;
		phandle = <0x06>;

		__overlay__ {
			status = "okay";
			#address-cells = <0x01>;
			#size-cells = <0x00>;

			mcp251xfd@0 {
				compatible = "microchip,mcp251xfd";
				reg = <0x00>;
				pinctrl-names = "default";
				pinctrl-0 = <0x01>;
				spi-max-frequency = <0x1312d00>;
				interrupt-parent = <0xffffffff>;
				interrupts = <0x19 0x08>;
				clocks = <0x02>;
				phandle = <0x03>;
			};
		};
	};

	fragment@11 {
		target = <0x03>;

		__dormant__ {
			microchip,rx-int-gpios = <0xffffffff 0xff 0x01>;
			phandle = <0x07>;
		};
	};

	fragment@12 {
		target = <0xffffffff>;

		__dormant__ {

			mcp251xfd_xceiver_pins {
				brcm,pins = <0xff>;
				brcm,function = <0x01>;
				phandle = <0x04>;
			};
		};
	};

	fragment@13 {
		target-path = "/";

		__dormant__ {

			reg_mcp251xfd_xceiver {
				compatible = "regulator-fixed";
				regulator-name = "mcp251xfd_xceiver";
				regulator-min-microvolt = <0x325aa0>;
				regulator-max-microvolt = <0x325aa0>;
				gpio = <0xffffffff 0x04 0x00>;
				pinctrl-names = "default";
				pinctrl-0 = <0x04>;
				phandle = <0x05>;
			};
		};
	};

	fragment@14 {
		target = <0x03>;

		__dormant__ {
			xceiver-supply = <0x05>;
		};
	};

	__overrides__ {
		spi0-0 = [00 00 00 00 2b 30 00 00 00 00 06 74 61 72 67 65 74 3a 30 3d 00 ff ff ff ff 00 00 00 03 72 65 67 3a 30 3d 30 00 00 00 00 01 6e 61 6d 65 3d 6d 63 70 32 35 31 78 66 64 5f 73 70 69 30 5f 30 5f 70 69 6e 73 00 00 00 00 02 6e 61 6d 65 3d 6d 63 70 32 35 31 78 66 64 2d 73 70 69 30 2d 30 2d 6f 73 63 00 00 00 00 04 6e 61 6d 65 3d 6d 63 70 32 35 31 78 66 64 5f 73 70 69 30 5f 30 5f 78 63 65 69 76 65 72 5f 70 69 6e 73 00 00 00 00 05 6e 61 6d 65 3d 72 65 67 2d 6d 63 70 32 35 31 78 66 64 2d 73 70 69 30 2d 30 2d 78 63 65 69 76 65 72 00 00 00 00 05 72 65 67 75 6c 61 74 6f 72 2d 6e 61 6d 65 3d 6d 63 70 32 35 31 78 66 64 2d 73 70 69 30 2d 30 2d 78 63 65 69 76 65 72 00];
		spi0-1 = [00 00 00 00 2b 31 00 00 00 00 06 74 61 72 67 65 74 3a 30 3d 00 ff ff ff ff 00 00 00 03 72 65 67 3a 30 3d 31 00 00 00 00 01 6e 61 6d 65 3d 6d 63 70 32 35 31 78 66 64 5f 73 70 69 30 5f 31 5f 70 69 6e 73 00 00 00 00 02 6e 61 6d 65 3d 6d 63 70 32 35 31 78 66 64 2d 73 70 69 30 2d 31 2d 6f 73 63 00 00 00 00 04 6e 61 6d 65 3d 6d 63 70 32 35 31 78 66 64 5f 73 70 69 30 5f 31 5f 78 63 65 69 76 65 72 5f 70 69 6e 73 00 00 00 00 05 6e 61 6d 65 3d 72 65 67 2d 6d 63 70 32 35 31 78 66 64 2d 73 70 69 30 2d 31 2d 78 63 65 69 76 65 72 00 00 00 00 05 72 65 67 75 6c 61 74 6f 72 2d 6e 61 6d 65 3d 6d 63 70 32 35 31 78 66 64 2d 73 70 69 30 2d 31 2d 78 63 65 69 76 65 72 00];
		spi1-0 = [00 00 00 00 2b 32 00 00 00 00 06 74 61 72 67 65 74 3a 30 3d 00 ff ff ff ff 00 00 00 03 72 65 67 3a 30 3d 30 00 00 00 00 01 6e 61 6d 65 3d 6d 63 70 32 35 31 78 66 64 5f 73 70 69 31 5f 30 5f 70 69 6e 73 00 00 00 00 02 6e 61 6d 65 3d 6d 63 70 32 35 31 78 66 64 2d 73 70 69 31 2d 30 2d 6f 73 63 00 00 00 00 04 6e 61 6d 65 3d 6d 63 70 32 35 31 78 66 64 5f 73 70 69 31 5f 30 5f 78 63 65 69 76 65 72 5f 70 69 6e 73 00 00 00 00 05 6e 61 6d 65 3d 72 65 67 2d 6d 63 70 32 35 31 78 66 64 2d 73 70 69 31 2d 30 2d 78 63 65 69 76 65 72 00 00 00 00 05 72 65 67 75 6c 61 74 6f 72 2d 6e 61 6d 65 3d 6d 63 70 32 35 31 78 66 64 2d 73 70 69 31 2d 30 2d 78 63 65 69 76 65 72 00];
		spi1-1 = [00 00 00 00 2b 33 00 00 00 00 06 74 61 72 67 65 74 3a 30 3d 00 ff ff ff ff 00 00 00 03 72 65 67 3a 30 3d 31 00 00 00 00 01 6e 61 6d 65 3d 6d 63 70 32 35 31 78 66 64 5f 73 70 69 31 5f 31 5f 70 69 6e 73 00 00 00 00 02 6e 61 6d 65 3d 6d 63 70 32 35 31 78 66 64 2d 73 70 69 31 2d 31 2d 6f 73 63 00 00 00 00 04 6e 61 6d 65 3d 6d 63 70 32 35 31 78 66 64 5f 73 70 69 31 5f 31 5f 78 63 65 69 76 65 72 5f 70 69 6e 73 00 00 00 00 05 6e 61 6d 65 3d 72 65 67 2d 6d 63 70 32 35 31 78 66 64 2d 73 70 69 31 2d 31 2d 78 63 65 69 76 65 72 00 00 00 00 05 72 65 67 75 6c 61 74 6f 72 2d 6e 61 6d 65 3d 6d 63 70 32 35 31 78 66 64 2d 73 70 69 31 2d 31 2d 78 63 65 69 76 65 72 00];
		spi1-2 = [00 00 00 00 2b 34 00 00 00 00 06 74 61 72 67 65 74 3a 30 3d 00 ff ff ff ff 00 00 00 03 72 65 67 3a 30 3d 32 00 00 00 00 01 6e 61 6d 65 3d 6d 63 70 32 35 31 78 66 64 5f 73 70 69 31 5f 32 5f 70 69 6e 73 00 00 00 00 02 6e 61 6d 65 3d 6d 63 70 32 35 31 78 66 64 2d 73 70 69 31 2d 32 2d 6f 73 63 00 00 00 00 04 6e 61 6d 65 3d 6d 63 70 32 35 31 78 66 64 5f 73 70 69 31 5f 32 5f 78 63 65 69 76 65 72 5f 70 69 6e 73 00 00 00 00 05 6e 61 6d 65 3d 72 65 67 2d 6d 63 70 32 35 31 78 66 64 2d 73 70 69 31 2d 32 2d 78 63 65 69 76 65 72 00 00 00 00 05 72 65 67 75 6c 61 74 6f 72 2d 6e 61 6d 65 3d 6d 63 70 32 35 31 78 66 64 2d 73 70 69 31 2d 32 2d 78 63 65 69 76 65 72 00];
		spi2-0 = [00 00 00 00 2b 35 00 00 00 00 06 74 61 72 67 65 74 3a 30 3d 00 ff ff ff ff 00 00 00 03 72 65 67 3a 30 3d 30 00 00 00 00 01 6e 61 6d 65 3d 6d 63 70 32 35 31 78 66 64 5f 73 70 69 32 5f 30 5f 70 69 6e 73 00 00 00 00 02 6e 61 6d 65 3d 6d 63 70 32 35 31 78 66 64 2d 73 70 69 32 2d 30 2d 6f 73 63 00 00 00 00 04 6e 61 6d 65 3d 6d 63 70 32 35 31 78 66 64 5f 73 70 69 32 5f 30 5f 78 63 65 69 76 65 72 5f 70 69 6e 73 00 00 00 00 05 6e 61 6d 65 3d 72 65 67 2d 6d 63 70 32 35 31 78 66 64 2d 73 70 69 32 2d 30 2d 78 63 65 69 76 65 72 00 00 00 00 05 72 65 67 75 6c 61 74 6f 72 2d 6e 61 6d 65 3d 6d 63 70 32 35 31 78 66 64 2d 73 70 69 32 2d 30 2d 78 63 65 69 76 65 72 00];
		spi2-1 = [00 00 00 00 2b 36 00 00 00 00 06 74 61 72 67 65 74 3a 30 3d 00 ff ff ff ff 00 00 00 03 72 65 67 3a 30 3d 31 00 00 00 00 01 6e 61 6d 65 3d 6d 63 70 32 35 31 78 66 64 5f 73 70 69 32 5f 31 5f 70 69 6e 73 00 00 00 00 02 6e 61 6d 65 3d 6d 63 70 32 35 31 78 66 64 2d 73 70 69 32 2d 31 2d 6f 73 63 00 00 00 00 04 6e 61 6d 65 3d 6d 63 70 32 35 31 78 66 64 5f 73 70 69 32 5f 31 5f 78 63 65 69 76 65 72 5f 70 69 6e 73 00 00 00 00 05 6e 61 6d 65 3d 72 65 67 2d 6d 63 70 32 35 31 78 66 64 2d 73 70 69 32 2d 31 2d 78 63 65 69 76 65 72 00 00 00 00 05 72 65 67 75 6c 61 74 6f 72 2d 6e 61 6d 65 3d 6d 63 70 32 35 31 78 66 64 2d 73 70 69 32 2d 31 2d 78 63 65 69 76 65 72 00];
		spi2-2 = [00 00 00 00 2b 37 00 00 00 00 06 74 61 72 67 65 74 3a 30 3d 00 ff ff ff ff 00 00 00 03 72 65 67 3a 30 3d 32 00 00 00 00 01 6e 61 6d 65 3d 6d 63 70 32 35 31 78 66 64 5f 73 70 69 32 5f 32 5f 70 69 6e 73 00 00 00 00 02 6e 61 6d 65 3d 6d 63 70 32 35 31 78 66 64 2d 73 70 69 32 2d 32 2d 6f 73 63 00 00 00 00 04 6e 61 6d 65 3d 6d 63 70 32 35 31 78 66 64 5f 73 70 69 32 5f 32 5f 78 63 65 69 76 65 72 5f 70 69 6e 73 00 00 00 00 05 6e 61 6d 65 3d 72 65 67 2d 6d 63 70 32 35 31 78 66 64 2d 73 70 69 32 2d 32 2d 78 63 65 69 76 65 72 00 00 00 00 05 72 65 67 75 6c 61 74 6f 72 2d 6e 61 6d 65 3d 6d 63 70 32 35 31 78 66 64 2d 73 70 69 32 2d 32 2d 78 63 65 69 76 65 72 00];
		oscillator = [00 00 00 02 63 6c 6f 63 6b 2d 66 72 65 71 75 65 6e 63 79 3a 30 00];
		speed = <0x03 0x7370692d 0x6d61782d 0x66726571 0x75656e63 0x793a3000>;
		interrupt = [00 00 00 01 62 72 63 6d 2c 70 69 6e 73 3a 30 00 00 00 00 03 69 6e 74 65 72 72 75 70 74 73 3a 30 00];
		rx_interrupt = [00 00 00 00 2b 31 31 00 00 00 00 01 62 72 63 6d 2c 70 69 6e 73 3a 34 00 00 00 00 07 6d 69 63 72 6f 63 68 69 70 2c 72 78 2d 69 6e 74 2d 67 70 69 6f 73 3a 34 00];
		xceiver_enable = [00 00 00 00 2b 31 32 2b 31 33 2b 31 34 00 00 00 00 04 62 72 63 6d 2c 70 69 6e 73 3a 30 00 00 00 00 05 67 70 69 6f 3a 34 00];
		xceiver_active_high = <0x05 0x656e6162 0x6c652d61 0x63746976 0x652d6869 0x67683f00>;
	};

	__symbols__ {
		mcp251xfd_pins = "/fragment@8/__overlay__/mcp251xfd_pins";
		clk_mcp251xfd_osc = "/fragment@9/__overlay__/mcp251xfd-osc";
		mcp251xfd_frag = "/fragment@10";
		mcp251xfd = "/fragment@10/__overlay__/mcp251xfd@0";
		mcp251xfd_rx_int_gpios = "/fragment@11/__dormant__";
		mcp251xfd_xceiver_pins = "/fragment@12/__dormant__/mcp251xfd_xceiver_pins";
		reg_mcp251xfd_xceiver = "/fragment@13/__dormant__/reg_mcp251xfd_xceiver";
	};

	__fixups__ {
		spidev0 = "/fragment@0:target:0";
		spidev1 = "/fragment@1:target:0";
		gpio = "/fragment@8:target:0\0/fragment@10/__overlay__/mcp251xfd@0:interrupt-parent:0\0/fragment@11/__dormant__:microchip,rx-int-gpios:0\0/fragment@12:target:0\0/fragment@13/__dormant__/reg_mcp251xfd_xceiver:gpio:0";
		spi0 = "/fragment@10:target:0\0/__overrides__:spi0-0:21\0/__overrides__:spi0-1:21";
		spi1 = "/__overrides__:spi1-0:21\0/__overrides__:spi1-1:21\0/__overrides__:spi1-2:21";
		spi2 = "/__overrides__:spi2-0:21\0/__overrides__:spi2-1:21\0/__overrides__:spi2-2:21";
	};

	__local_fixups__ {

		fragment@10 {

			__overlay__ {

				mcp251xfd@0 {
					pinctrl-0 = <0x00>;
					clocks = <0x00>;
				};
			};
		};

		fragment@11 {
			target = <0x00>;
		};

		fragment@13 {

			__dormant__ {

				reg_mcp251xfd_xceiver {
					pinctrl-0 = <0x00>;
				};
			};
		};

		fragment@14 {
			target = <0x00>;

			__dormant__ {
				xceiver-supply = <0x00>;
			};
		};

		__overrides__ {
			spi0-0 = <0x07 0x19 0x25 0x44 0x62 0x89 0xaf>;
			spi0-1 = <0x07 0x19 0x25 0x44 0x62 0x89 0xaf>;
			spi1-0 = <0x07 0x19 0x25 0x44 0x62 0x89 0xaf>;
			spi1-1 = <0x07 0x19 0x25 0x44 0x62 0x89 0xaf>;
			spi1-2 = <0x07 0x19 0x25 0x44 0x62 0x89 0xaf>;
			spi2-0 = <0x07 0x19 0x25 0x44 0x62 0x89 0xaf>;
			spi2-1 = <0x07 0x19 0x25 0x44 0x62 0x89 0xaf>;
			spi2-2 = <0x07 0x19 0x25 0x44 0x62 0x89 0xaf>;
			oscillator = <0x00>;
			speed = <0x00>;
			interrupt = <0x00 0x10>;
			rx_interrupt = <0x08 0x18>;
			xceiver_enable = <0x0e 0x1e>;
			xceiver_active_high = <0x00>;
		};
	};
};
