/dts-v1/;

/ {
	compatible = "brcm,bcm2835";

	fragment@0 {
		target = <0xffffffff>;

		__overlay__ {
			#address-cells = <0x01>;
			#size-cells = <0x00>;
			status = "okay";

			sn3218@54 {
				compatible = "si-en,sn3218";
				reg = <0x54>;
				#address-cells = <0x01>;
				#size-cells = <0x00>;
				status = "okay";

				led@1 {
					reg = <0x01>;
					label = "piglow:red:led1";
				};

				led@2 {
					reg = <0x02>;
					label = "piglow:orange:led2";
				};

				led@3 {
					reg = <0x03>;
					label = "piglow:yellow:led3";
				};

				led@4 {
					reg = <0x04>;
					label = "piglow:green:led4";
				};

				led@5 {
					reg = <0x05>;
					label = "piglow:blue:led5";
				};

				led@6 {
					reg = <0x06>;
					label = "piglow:green:led6";
				};

				led@7 {
					reg = <0x07>;
					label = "piglow:red:led7";
				};

				led@8 {
					reg = <0x08>;
					label = "piglow:orange:led8";
				};

				led@9 {
					reg = <0x09>;
					label = "piglow:yellow:led9";
				};

				led@10 {
					reg = <0x0a>;
					label = "piglow:white:led10";
				};

				led@11 {
					reg = <0x0b>;
					label = "piglow:white:led11";
				};

				led@12 {
					reg = <0x0c>;
					label = "piglow:blue:led12";
				};

				led@13 {
					reg = <0x0d>;
					label = "piglow:white:led13";
				};

				led@14 {
					reg = <0x0e>;
					label = "piglow:green:led14";
				};

				led@15 {
					reg = <0x0f>;
					label = "piglow:blue:led15";
				};

				led@16 {
					reg = <0x10>;
					label = "piglow:yellow:led16";
				};

				led@17 {
					reg = <0x11>;
					label = "piglow:orange:led17";
				};

				led@18 {
					reg = <0x12>;
					label = "piglow:red:led18";
				};
			};
		};
	};

	__fixups__ {
		i2c_arm = "/fragment@0:target:0";
	};
};
