/dts-v1/;

/ {
	compatible = "brcm,bcm2835";

	fragment@1 {
		target = <0xffffffff>;

		__overlay__ {

			hdmi_backlight_hwhack_gpio_pins {
				brcm,pins = <0x11>;
				brcm,function = <0x01>;
				phandle = <0x01>;
			};
		};
	};

	fragment@2 {
		target-path = "/";

		__overlay__ {

			hdmi_backlight_hwhack_gpio {
				compatible = "gpio-backlight";
				pinctrl-names = "default";
				pinctrl-0 = <0x01>;
				gpios = <0xffffffff 0x11 0x00>;
				default-on;
				phandle = <0x02>;
			};
		};
	};

	__overrides__ {
		gpio_pin = <0x02 0x6770696f 0x733a3400 0x01 0x6272636d 0x2c70696e 0x733a3000>;
		active_low = <0x02 0x6770696f 0x733a3800>;
	};

	__symbols__ {
		hdmi_backlight_hwhack_gpio_pins = "/fragment@1/__overlay__/hdmi_backlight_hwhack_gpio_pins";
		hdmi_backlight_hwhack_gpio = "/fragment@2/__overlay__/hdmi_backlight_hwhack_gpio";
	};

	__fixups__ {
		gpio = "/fragment@1:target:0\0/fragment@2/__overlay__/hdmi_backlight_hwhack_gpio:gpios:0";
	};

	__local_fixups__ {

		fragment@2 {

			__overlay__ {

				hdmi_backlight_hwhack_gpio {
					pinctrl-0 = <0x00>;
				};
			};
		};

		__overrides__ {
			gpio_pin = <0x00 0x0c>;
			active_low = <0x00>;
		};
	};
};
