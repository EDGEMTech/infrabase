/dts-v1/;

/ {
	compatible = "brcm,bcm2835";

	fragment@0 {
		target = <0xffffffff>;

		__overlay__ {
			compatible = "brcm,bcm2708-usb";
			status = "okay";
		};
	};

	__fixups__ {
		usb = "/fragment@0:target:0";
	};
};
