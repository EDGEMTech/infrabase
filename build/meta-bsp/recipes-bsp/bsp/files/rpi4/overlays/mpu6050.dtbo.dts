/dts-v1/;

/ {
	compatible = "brcm,bcm2835";

	fragment@0 {
		target = <0xffffffff>;

		__overlay__ {
			#address-cells = <0x01>;
			#size-cells = <0x00>;
			status = "okay";
			clock-frequency = <0x61a80>;

			mpu6050@68 {
				compatible = "invensense,mpu6050";
				reg = <0x68>;
				interrupt-parent = <0xffffffff>;
				interrupts = <0x04 0x01>;
				phandle = <0x01>;
			};
		};
	};

	__overrides__ {
		interrupt = [00 00 00 01 69 6e 74 65 72 72 75 70 74 73 3a 30 00];
		addr = [00 00 00 01 72 65 67 3a 30 00];
	};

	__symbols__ {
		mpu6050 = "/fragment@0/__overlay__/mpu6050@68";
	};

	__fixups__ {
		i2c1 = "/fragment@0:target:0";
		gpio = "/fragment@0/__overlay__/mpu6050@68:interrupt-parent:0";
	};

	__local_fixups__ {

		__overrides__ {
			interrupt = <0x00>;
			addr = <0x00>;
		};
	};
};
