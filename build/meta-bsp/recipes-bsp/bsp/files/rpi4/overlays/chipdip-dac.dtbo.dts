/dts-v1/;

/ {
	compatible = "brcm,bcm2835";

	fragment@0 {
		target = <0xffffffff>;

		__overlay__ {
			status = "okay";
		};
	};

	fragment@1 {
		target-path = "/";

		__overlay__ {

			spdif-transmitter {
				#address-cells = <0x00>;
				#size-cells = <0x00>;
				#sound-dai-cells = <0x00>;
				compatible = "linux,spdif-dit";
				status = "okay";
			};
		};
	};

	fragment@2 {
		target = <0xffffffff>;

		__overlay__ {
			compatible = "chipdip,chipdip-dac";
			i2s-controller = <0xffffffff>;
			sr0-gpios = <0xffffffff 0x05 0x00>;
			sr1-gpios = <0xffffffff 0x06 0x00>;
			sr2-gpios = <0xffffffff 0x0c 0x00>;
			res0-gpios = <0xffffffff 0x18 0x00>;
			res1-gpios = <0xffffffff 0x1b 0x00>;
			mute-gpios = <0xffffffff 0x04 0x00>;
			sdwn-gpios = <0xffffffff 0x0d 0x00>;
			status = "okay";
		};
	};

	__fixups__ {
		i2s = "/fragment@0:target:0\0/fragment@2/__overlay__:i2s-controller:0";
		sound = "/fragment@2:target:0";
		gpio = "/fragment@2/__overlay__:sr0-gpios:0\0/fragment@2/__overlay__:sr1-gpios:0\0/fragment@2/__overlay__:sr2-gpios:0\0/fragment@2/__overlay__:res0-gpios:0\0/fragment@2/__overlay__:res1-gpios:0\0/fragment@2/__overlay__:mute-gpios:0\0/fragment@2/__overlay__:sdwn-gpios:0";
	};
};
