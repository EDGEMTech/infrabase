/dts-v1/;

/ {
	compatible = "brcm,bcm2835";

	fragment@0 {
		target = <0xffffffff>;

		__overlay__ {

			shutdown_button_pins@3 {
				brcm,pins = <0x03>;
				brcm,function = <0x00>;
				brcm,pull = <0x02>;
				phandle = <0x01>;
			};
		};
	};

	fragment@1 {
		target-path = "/soc";

		__overlay__ {

			shutdown_button@3 {
				compatible = "gpio-keys";
				pinctrl-names = "default";
				pinctrl-0 = <0x01>;
				status = "okay";
				phandle = <0x03>;

				shutdown {
					label = "shutdown";
					linux,code = <0x74>;
					gpios = <0xffffffff 0x03 0x01>;
					debounce-interval = <0x64>;
					phandle = <0x02>;
				};
			};
		};
	};

	__overrides__ {
		gpio_pin = <0x02 0x6770696f 0x733a3400 0x03 0x7265673a 0x30000000 0x17265 0x673a3000 0x01 0x6272636d 0x2c70696e 0x733a3000>;
		gpio_pull = <0x01 0x6272636d 0x2c70756c 0x6c3a3000>;
		active_low = <0x02 0x6770696f 0x733a3800>;
		debounce = <0x02 0x6465626f 0x756e6365 0x2d696e74 0x65727661 0x6c3a3000>;
	};

	__symbols__ {
		pin_state = "/fragment@0/__overlay__/shutdown_button_pins@3";
		shutdown_button = "/fragment@1/__overlay__/shutdown_button@3";
		button = "/fragment@1/__overlay__/shutdown_button@3/shutdown";
	};

	__fixups__ {
		gpio = "/fragment@0:target:0\0/fragment@1/__overlay__/shutdown_button@3/shutdown:gpios:0";
	};

	__local_fixups__ {

		fragment@1 {

			__overlay__ {

				shutdown_button@3 {
					pinctrl-0 = <0x00>;
				};
			};
		};

		__overrides__ {
			gpio_pin = <0x00 0x0c 0x16 0x20>;
			gpio_pull = <0x00>;
			active_low = <0x00>;
			debounce = <0x00>;
		};
	};
};
