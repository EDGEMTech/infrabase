/dts-v1/;

/ {
	compatible = "brcm,bcm2835";

	fragment@0 {
		target = <0xffffffff>;

		__overlay__ {
			status = "okay";
		};
	};

	fragment@1 {
		target-path = "/";

		__overlay__ {

			dacplusdsp-codec {
				#sound-dai-cells = <0x00>;
				compatible = "hifiberry,dacplusdsp";
				status = "okay";
			};
		};
	};

	fragment@2 {
		target = <0xffffffff>;

		__overlay__ {
			compatible = "hifiberrydacplusdsp,hifiberrydacplusdsp-soundcard";
			i2s-controller = <0xffffffff>;
			status = "okay";
		};
	};

	__fixups__ {
		i2s = "/fragment@0:target:0\0/fragment@2/__overlay__:i2s-controller:0";
		sound = "/fragment@2:target:0";
	};
};
