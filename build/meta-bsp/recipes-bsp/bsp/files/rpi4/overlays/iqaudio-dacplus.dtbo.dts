/dts-v1/;

/ {
	compatible = "brcm,bcm2835";

	fragment@0 {
		target = <0xffffffff>;

		__overlay__ {
			status = "okay";
		};
	};

	fragment@1 {
		target = <0xffffffff>;

		__overlay__ {
			#address-cells = <0x01>;
			#size-cells = <0x00>;
			status = "okay";

			pcm5122@4c {
				#sound-dai-cells = <0x00>;
				compatible = "ti,pcm5122";
				reg = <0x4c>;
				AVDD-supply = <0xffffffff>;
				DVDD-supply = <0xffffffff>;
				CPVDD-supply = <0xffffffff>;
				status = "okay";
			};
		};
	};

	fragment@2 {
		target = <0xffffffff>;

		__overlay__ {
			compatible = "iqaudio,iqaudio-dac";
			i2s-controller = <0xffffffff>;
			mute-gpios = <0xffffffff 0x16 0x00>;
			status = "okay";
			phandle = <0x01>;
		};
	};

	__overrides__ {
		24db_digital_gain = [00 00 00 01 69 71 61 75 64 69 6f 2c 32 34 64 62 5f 64 69 67 69 74 61 6c 5f 67 61 69 6e 3f 00];
		auto_mute_amp = [00 00 00 01 69 71 61 75 64 69 6f 2d 64 61 63 2c 61 75 74 6f 2d 6d 75 74 65 2d 61 6d 70 3f 00];
		unmute_amp = <0x01 0x69716175 0x64696f2d 0x6461632c 0x756e6d75 0x74652d61 0x6d703f00>;
	};

	__symbols__ {
		iqaudio_dac = "/fragment@2/__overlay__";
	};

	__fixups__ {
		i2s = "/fragment@0:target:0\0/fragment@2/__overlay__:i2s-controller:0";
		i2c1 = "/fragment@1:target:0";
		vdd_3v3_reg = "/fragment@1/__overlay__/pcm5122@4c:AVDD-supply:0\0/fragment@1/__overlay__/pcm5122@4c:DVDD-supply:0\0/fragment@1/__overlay__/pcm5122@4c:CPVDD-supply:0";
		sound = "/fragment@2:target:0";
		gpio = "/fragment@2/__overlay__:mute-gpios:0";
	};

	__local_fixups__ {

		__overrides__ {
			24db_digital_gain = <0x00>;
			auto_mute_amp = <0x00>;
			unmute_amp = <0x00>;
		};
	};
};
