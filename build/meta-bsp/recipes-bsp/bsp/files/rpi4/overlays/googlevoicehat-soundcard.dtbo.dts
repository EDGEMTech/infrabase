/dts-v1/;

/ {
	compatible = "brcm,bcm2835";

	fragment@0 {
		target = <0xffffffff>;

		__overlay__ {
			status = "okay";
		};
	};

	fragment@1 {
		target = <0xffffffff>;

		__overlay__ {

			googlevoicehat_pins {
				brcm,pins = <0x10>;
				brcm,function = <0x01>;
				brcm,pull = <0x00>;
				phandle = <0x01>;
			};
		};
	};

	fragment@2 {
		target-path = "/";

		__overlay__ {

			voicehat-codec {
				#sound-dai-cells = <0x00>;
				compatible = "google,voicehat";
				pinctrl-names = "default";
				pinctrl-0 = <0x01>;
				sdmode-gpios = <0xffffffff 0x10 0x00>;
				status = "okay";
			};
		};
	};

	fragment@3 {
		target = <0xffffffff>;

		__overlay__ {
			compatible = "googlevoicehat,googlevoicehat-soundcard";
			i2s-controller = <0xffffffff>;
			status = "okay";
		};
	};

	__symbols__ {
		googlevoicehat_pins = "/fragment@1/__overlay__/googlevoicehat_pins";
	};

	__fixups__ {
		i2s = "/fragment@0:target:0\0/fragment@3/__overlay__:i2s-controller:0";
		gpio = "/fragment@1:target:0\0/fragment@2/__overlay__/voicehat-codec:sdmode-gpios:0";
		sound = "/fragment@3:target:0";
	};

	__local_fixups__ {

		fragment@2 {

			__overlay__ {

				voicehat-codec {
					pinctrl-0 = <0x00>;
				};
			};
		};
	};
};
