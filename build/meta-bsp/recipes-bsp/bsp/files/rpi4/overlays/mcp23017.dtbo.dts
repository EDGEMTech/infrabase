/dts-v1/;

/ {
	compatible = "brcm,bcm2835";

	fragment@0 {
		target = <0xffffffff>;

		__overlay__ {
			status = "okay";
		};
	};

	fragment@1 {
		target = <0xffffffff>;

		__overlay__ {

			mcp23017_pins@20 {
				brcm,pins = <0x04>;
				brcm,function = <0x00>;
				phandle = <0x02>;
			};
		};
	};

	fragment@2 {
		target = <0xffffffff>;

		__overlay__ {
			#address-cells = <0x01>;
			#size-cells = <0x00>;

			mcp@20 {
				compatible = "microchip,mcp23017";
				reg = <0x20>;
				gpio-controller;
				#gpio-cells = <0x02>;
				status = "okay";
				phandle = <0x01>;
			};
		};
	};

	fragment@3 {
		target = <0x01>;

		__dormant__ {
			compatible = "microchip,mcp23008";
		};
	};

	fragment@4 {
		target = <0x01>;

		__overlay__ {
			#interrupt-cells = <0x02>;
			interrupt-parent = <0xffffffff>;
			interrupts = <0x04 0x02>;
			interrupt-controller;
			microchip,irq-mirror;
			phandle = <0x03>;
		};
	};

	__overrides__ {
		gpiopin = [00 00 00 02 62 72 63 6d 2c 70 69 6e 73 3a 30 00 00 00 00 03 69 6e 74 65 72 72 75 70 74 73 3a 30 00];
		addr = <0x01 0x7265673a 0x30000000 0x27265 0x673a3000>;
		mcp23008 = [00 00 00 00 3d 33 00];
		noints = [00 00 00 00 21 31 21 34 00];
	};

	__symbols__ {
		mcp23017_pins = "/fragment@1/__overlay__/mcp23017_pins@20";
		mcp23017 = "/fragment@2/__overlay__/mcp@20";
		mcp23017_irq = "/fragment@4/__overlay__";
	};

	__fixups__ {
		i2c1 = "/fragment@0:target:0\0/fragment@2:target:0";
		gpio = "/fragment@1:target:0\0/fragment@4/__overlay__:interrupt-parent:0";
	};

	__local_fixups__ {

		fragment@3 {
			target = <0x00>;
		};

		fragment@4 {
			target = <0x00>;
		};

		__overrides__ {
			gpiopin = <0x00 0x10>;
			addr = <0x00 0x0a>;
		};
	};
};
