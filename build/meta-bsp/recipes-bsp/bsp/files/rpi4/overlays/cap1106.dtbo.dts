/dts-v1/;

/ {
	compatible = "brcm,bcm2835";

	fragment@0 {
		target = <0xffffffff>;

		__overlay__ {
			status = "okay";

			cap1106@28 {
				compatible = "microchip,cap1106";
				pinctrl-0 = <0x01>;
				pinctrl-names = "default";
				interrupt-parent = <0xffffffff>;
				interrupts = <0x04 0x02>;
				reg = <0x28>;
				autorepeat;
				microchip,sensor-gain = <0x02>;
				linux,keycodes = <0x02 0x03 0x04 0x05 0x06 0x07>;
				#address-cells = <0x01>;
				#size-cells = <0x00>;
				status = "okay";
				phandle = <0x02>;
			};
		};
	};

	fragment@1 {
		target = <0xffffffff>;

		__overlay__ {

			cap1106_pins {
				brcm,pins = <0x04>;
				brcm,function = <0x00>;
				brcm,pull = <0x00>;
				phandle = <0x01>;
			};
		};
	};

	__overrides__ {
		int_pin = [00 00 00 02 69 6e 74 65 72 72 75 70 74 73 3a 30 00 00 00 00 01 62 72 63 6d 2c 70 69 6e 73 3a 30 00];
	};

	__symbols__ {
		cap1106 = "/fragment@0/__overlay__/cap1106@28";
		cap1106_pins = "/fragment@1/__overlay__/cap1106_pins";
	};

	__fixups__ {
		i2c1 = "/fragment@0:target:0";
		gpio = "/fragment@0/__overlay__/cap1106@28:interrupt-parent:0\0/fragment@1:target:0";
	};

	__local_fixups__ {

		fragment@0 {

			__overlay__ {

				cap1106@28 {
					pinctrl-0 = <0x00>;
				};
			};
		};

		__overrides__ {
			int_pin = <0x00 0x11>;
		};
	};
};
