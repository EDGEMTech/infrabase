/dts-v1/;

/ {
	compatible = "brcm,bcm2835";

	fragment@0 {
		target = <0xffffffff>;

		__overlay__ {
			status = "okay";
		};
	};

	fragment@1 {
		target-path = "/";

		__overlay__ {

			wm8960_mclk {
				compatible = "fixed-clock";
				#clock-cells = <0x00>;
				clock-frequency = <0xbb8000>;
				phandle = <0x02>;
			};
		};
	};

	fragment@2 {
		target = <0xffffffff>;

		__overlay__ {
			#address-cells = <0x01>;
			#size-cells = <0x00>;
			status = "okay";

			wm8960 {
				compatible = "wlf,wm8960";
				reg = <0x1a>;
				#sound-dai-cells = <0x00>;
				AVDD-supply = <0xffffffff>;
				DVDD-supply = <0xffffffff>;
				phandle = <0x01>;
			};
		};
	};

	fragment@3 {
		target = <0xffffffff>;

		__overlay__ {
			compatible = "simple-audio-card";
			simple-audio-card,format = "i2s";
			simple-audio-card,name = "wm8960-soundcard";
			status = "okay";
			simple-audio-card,widgets = "Microphone\0Mic Jack\0Line\0Line In\0Line\0Line Out\0Speaker\0Speaker\0Headphone\0Headphone Jack";
			simple-audio-card,routing = "Headphone Jack\0HP_L\0Headphone Jack\0HP_R\0Speaker\0SPK_LP\0Speaker\0SPK_LN\0LINPUT1\0Mic Jack\0LINPUT3\0Mic Jack\0RINPUT1\0Mic Jack\0RINPUT2\0Mic Jack";
			phandle = <0x03>;

			simple-audio-card,cpu {
				sound-dai = <0xffffffff>;
			};

			simple-audio-card,codec {
				sound-dai = <0x01>;
				clocks = <0x02>;
				clock-names = "mclk";
				phandle = <0x04>;
			};
		};
	};

	__overrides__ {
		alsaname = [00 00 00 03 73 69 6d 70 6c 65 2d 61 75 64 69 6f 2d 63 61 72 64 2c 6e 61 6d 65 00];
		compatible = [00 00 00 01 63 6f 6d 70 61 74 69 62 6c 65 00];
	};

	__symbols__ {
		wm8960_mclk = "/fragment@1/__overlay__/wm8960_mclk";
		wm8960 = "/fragment@2/__overlay__/wm8960";
		slave_overlay = "/fragment@3/__overlay__";
		dailink0_slave = "/fragment@3/__overlay__/simple-audio-card,codec";
	};

	__fixups__ {
		i2s = "/fragment@0:target:0\0/fragment@3/__overlay__/simple-audio-card,cpu:sound-dai:0";
		i2c1 = "/fragment@2:target:0";
		vdd_5v0_reg = "/fragment@2/__overlay__/wm8960:AVDD-supply:0";
		vdd_3v3_reg = "/fragment@2/__overlay__/wm8960:DVDD-supply:0";
		sound = "/fragment@3:target:0";
	};

	__local_fixups__ {

		fragment@3 {

			__overlay__ {

				simple-audio-card,codec {
					sound-dai = <0x00>;
					clocks = <0x00>;
				};
			};
		};

		__overrides__ {
			alsaname = <0x00>;
			compatible = <0x00>;
		};
	};
};
