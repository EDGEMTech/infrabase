/dts-v1/;

/ {
	compatible = "brcm,bcm2835";

	fragment@0 {
		target = <0xffffffff>;

		__overlay__ {
			compatible = "simple-audio-card";
			simple-audio-card,name = "ApplePi-DAC";
			status = "okay";

			simple-audio-card,dai-link@1 {
				format = "i2s";
				phandle = <0x02>;

				cpu {
					sound-dai = <0xffffffff>;
					dai-tdm-slot-num = <0x02>;
					dai-tdm-slot-width = <0x20>;
					phandle = <0x03>;
				};

				codec {
					sound-dai = <0x01>;
					phandle = <0x04>;
				};
			};
		};
	};

	fragment@1 {
		target-path = "/";

		__overlay__ {

			pcm1794a-codec {
				#sound-dai-cells = <0x00>;
				compatible = "ti,pcm1794a";
				status = "okay";
				phandle = <0x01>;
			};
		};
	};

	fragment@2 {
		target = <0xffffffff>;

		__overlay__ {
			#sound-dai-cells = <0x00>;
			status = "okay";
		};
	};

	__symbols__ {
		playback_link = "/fragment@0/__overlay__/simple-audio-card,dai-link@1";
		p_cpu_dai = "/fragment@0/__overlay__/simple-audio-card,dai-link@1/cpu";
		p_codec_dai = "/fragment@0/__overlay__/simple-audio-card,dai-link@1/codec";
		codec_out = "/fragment@1/__overlay__/pcm1794a-codec";
	};

	__fixups__ {
		sound = "/fragment@0:target:0";
		i2s = "/fragment@0/__overlay__/simple-audio-card,dai-link@1/cpu:sound-dai:0\0/fragment@2:target:0";
	};

	__local_fixups__ {

		fragment@0 {

			__overlay__ {

				simple-audio-card,dai-link@1 {

					codec {
						sound-dai = <0x00>;
					};
				};
			};
		};
	};
};
